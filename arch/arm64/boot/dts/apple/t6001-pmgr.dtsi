// SPDX-License-Identifier: GPL-2.0+ OR MIT
/*
 * PMGR Power domains for the Apple T6001 "M1 Max" SoC
 *
 * Copyright The Asahi Linux Contributors
 */

&pmgr {
	ps_pms_bridge: power-controller@100 {
		compatible = "apple,t6000-pmgr-pwrstate", "apple,pmgr-pwrstate";
		reg = <0x100 4>;
		#power-domain-cells = <0>;
		#reset-cells = <0>;
		label = "pms_bridge";
		apple,always-on; /* Core device */
	};

	ps_aic: power-controller@108 {
		compatible = "apple,t6000-pmgr-pwrstate", "apple,pmgr-pwrstate";
		reg = <0x108 4>;
		#power-domain-cells = <0>;
		#reset-cells = <0>;
		label = "aic";
		apple,always-on; /* Core device */
	};

	ps_dwi: power-controller@110 {
		compatible = "apple,t6000-pmgr-pwrstate", "apple,pmgr-pwrstate";
		reg = <0x110 4>;
		#power-domain-cells = <0>;
		#reset-cells = <0>;
		label = "dwi";
		apple,always-on; /* Core device */
	};

	ps_pms: power-controller@118 {
		compatible = "apple,t6000-pmgr-pwrstate", "apple,pmgr-pwrstate";
		reg = <0x118 4>;
		#power-domain-cells = <0>;
		#reset-cells = <0>;
		label = "pms";
		apple,always-on; /* Core device */
	};

	ps_gpio: power-controller@120 {
		compatible = "apple,t6000-pmgr-pwrstate", "apple,pmgr-pwrstate";
		reg = <0x120 4>;
		#power-domain-cells = <0>;
		#reset-cells = <0>;
		label = "gpio";
		power-domains = <&ps_pms>, <&ps_sio>;
	};

	ps_soc_dpe: power-controller@128 {
		compatible = "apple,t6000-pmgr-pwrstate", "apple,pmgr-pwrstate";
		reg = <0x128 4>;
		#power-domain-cells = <0>;
		#reset-cells = <0>;
		label = "soc_dpe";
		apple,always-on; /* Core device */
	};

	ps_pmgr_soc_ocla: power-controller@130 {
		compatible = "apple,t6000-pmgr-pwrstate", "apple,pmgr-pwrstate";
		reg = <0x130 4>;
		#power-domain-cells = <0>;
		#reset-cells = <0>;
		label = "pmgr_soc_ocla";
		power-domains = <&ps_pms>;
	};

	ps_pcie0_ref: power-controller@138 {
		compatible = "apple,t6000-pmgr-pwrstate", "apple,pmgr-pwrstate";
		reg = <0x138 4>;
		#power-domain-cells = <0>;
		#reset-cells = <0>;
		label = "pcie0_ref";
	};

	ps_pcie1_ref: power-controller@140 {
		compatible = "apple,t6000-pmgr-pwrstate", "apple,pmgr-pwrstate";
		reg = <0x140 4>;
		#power-domain-cells = <0>;
		#reset-cells = <0>;
		label = "pcie1_ref";
	};

	ps_apcie_st: power-controller@148 {
		compatible = "apple,t6000-pmgr-pwrstate", "apple,pmgr-pwrstate";
		reg = <0x148 4>;
		#power-domain-cells = <0>;
		#reset-cells = <0>;
		label = "apcie_st";
		power-domains = <&ps_pcie1_ref>;
	};

	ps_apcie_gp: power-controller@150 {
		compatible = "apple,t6000-pmgr-pwrstate", "apple,pmgr-pwrstate";
		reg = <0x150 4>;
		#power-domain-cells = <0>;
		#reset-cells = <0>;
		label = "apcie_gp";
		power-domains = <&ps_pcie0_ref>;
	};

	ps_devc0_ivdmc: power-controller@180 {
		compatible = "apple,t6000-pmgr-pwrstate", "apple,pmgr-pwrstate";
		reg = <0x180 4>;
		#power-domain-cells = <0>;
		#reset-cells = <0>;
		label = "devc0_ivdmc";
	};

	ps_amcc0: power-controller@188 {
		compatible = "apple,t6000-pmgr-pwrstate", "apple,pmgr-pwrstate";
		reg = <0x188 4>;
		#power-domain-cells = <0>;
		#reset-cells = <0>;
		label = "amcc0";
		apple,always-on; /* Memory controller */
	};

	ps_amcc2: power-controller@190 {
		compatible = "apple,t6000-pmgr-pwrstate", "apple,pmgr-pwrstate";
		reg = <0x190 4>;
		#power-domain-cells = <0>;
		#reset-cells = <0>;
		label = "amcc2";
		apple,always-on; /* Memory controller */
	};

	ps_dcs_00: power-controller@198 {
		compatible = "apple,t6000-pmgr-pwrstate", "apple,pmgr-pwrstate";
		reg = <0x198 4>;
		#power-domain-cells = <0>;
		#reset-cells = <0>;
		label = "dcs_00";
		apple,always-on; /* LPDDR5 interface */
	};

	ps_dcs_01: power-controller@1a0 {
		compatible = "apple,t6000-pmgr-pwrstate", "apple,pmgr-pwrstate";
		reg = <0x1a0 4>;
		#power-domain-cells = <0>;
		#reset-cells = <0>;
		label = "dcs_01";
		apple,always-on; /* LPDDR5 interface */
	};

	ps_dcs_02: power-controller@1a8 {
		compatible = "apple,t6000-pmgr-pwrstate", "apple,pmgr-pwrstate";
		reg = <0x1a8 4>;
		#power-domain-cells = <0>;
		#reset-cells = <0>;
		label = "dcs_02";
		apple,always-on; /* LPDDR5 interface */
	};

	ps_dcs_03: power-controller@1b0 {
		compatible = "apple,t6000-pmgr-pwrstate", "apple,pmgr-pwrstate";
		reg = <0x1b0 4>;
		#power-domain-cells = <0>;
		#reset-cells = <0>;
		label = "dcs_03";
		apple,always-on; /* LPDDR5 interface */
	};

	ps_dcs_08: power-controller@1b8 {
		compatible = "apple,t6000-pmgr-pwrstate", "apple,pmgr-pwrstate";
		reg = <0x1b8 4>;
		#power-domain-cells = <0>;
		#reset-cells = <0>;
		label = "dcs_08";
		apple,always-on; /* LPDDR5 interface */
	};

	ps_dcs_09: power-controller@1c0 {
		compatible = "apple,t6000-pmgr-pwrstate", "apple,pmgr-pwrstate";
		reg = <0x1c0 4>;
		#power-domain-cells = <0>;
		#reset-cells = <0>;
		label = "dcs_09";
		apple,always-on; /* LPDDR5 interface */
	};

	ps_dcs_10: power-controller@1c8 {
		compatible = "apple,t6000-pmgr-pwrstate", "apple,pmgr-pwrstate";
		reg = <0x1c8 4>;
		#power-domain-cells = <0>;
		#reset-cells = <0>;
		label = "dcs_10";
		apple,always-on; /* LPDDR5 interface */
	};

	ps_dcs_11: power-controller@1d0 {
		compatible = "apple,t6000-pmgr-pwrstate", "apple,pmgr-pwrstate";
		reg = <0x1d0 4>;
		#power-domain-cells = <0>;
		#reset-cells = <0>;
		label = "dcs_11";
		apple,always-on; /* LPDDR5 interface */
	};

	ps_afi: power-controller@1d8 {
		compatible = "apple,t6000-pmgr-pwrstate", "apple,pmgr-pwrstate";
		reg = <0x1d8 4>;
		#power-domain-cells = <0>;
		#reset-cells = <0>;
		label = "afi";
		apple,always-on; /* Apple Fabric, CPU inteface is here */
	};

	ps_afc: power-controller@1e0 {
		compatible = "apple,t6000-pmgr-pwrstate", "apple,pmgr-pwrstate";
		reg = <0x1e0 4>;
		#power-domain-cells = <0>;
		#reset-cells = <0>;
		label = "afc";
		apple,always-on; /* Apple Fabric, CPU inteface is here */
	};

	ps_afr: power-controller@1e8 {
		compatible = "apple,t6000-pmgr-pwrstate", "apple,pmgr-pwrstate";
		reg = <0x1e8 4>;
		#power-domain-cells = <0>;
		#reset-cells = <0>;
		label = "afr";
		/* Apple Fabric, media stuff: this can power down */
	};

	ps_afnc1_ioa: power-controller@1f0 {
		compatible = "apple,t6000-pmgr-pwrstate", "apple,pmgr-pwrstate";
		reg = <0x1f0 4>;
		#power-domain-cells = <0>;
		#reset-cells = <0>;
		label = "afnc1_ioa";
		apple,always-on; /* Apple Fabric */
		power-domains = <&ps_afi>;
	};

	ps_afnc0_ioa: power-controller@1f8 {
		compatible = "apple,t6000-pmgr-pwrstate", "apple,pmgr-pwrstate";
		reg = <0x1f8 4>;
		#power-domain-cells = <0>;
		#reset-cells = <0>;
		label = "afnc0_ioa";
		apple,always-on; /* Apple Fabric */
		power-domains = <&ps_afi>;
	};

	ps_afnc1_ls: power-controller@200 {
		compatible = "apple,t6000-pmgr-pwrstate", "apple,pmgr-pwrstate";
		reg = <0x200 4>;
		#power-domain-cells = <0>;
		#reset-cells = <0>;
		label = "afnc1_ls";
		apple,always-on; /* Apple Fabric */
		power-domains = <&ps_afnc1_ioa>;
	};

	ps_afnc0_ls: power-controller@208 {
		compatible = "apple,t6000-pmgr-pwrstate", "apple,pmgr-pwrstate";
		reg = <0x208 4>;
		#power-domain-cells = <0>;
		#reset-cells = <0>;
		label = "afnc0_ls";
		apple,always-on; /* Apple Fabric */
		power-domains = <&ps_afnc0_ioa>;
	};

	ps_afnc1_lw0: power-controller@210 {
		compatible = "apple,t6000-pmgr-pwrstate", "apple,pmgr-pwrstate";
		reg = <0x210 4>;
		#power-domain-cells = <0>;
		#reset-cells = <0>;
		label = "afnc1_lw0";
		apple,always-on; /* Apple Fabric */
		power-domains = <&ps_afnc1_ls>;
	};

	ps_afnc1_lw1: power-controller@218 {
		compatible = "apple,t6000-pmgr-pwrstate", "apple,pmgr-pwrstate";
		reg = <0x218 4>;
		#power-domain-cells = <0>;
		#reset-cells = <0>;
		label = "afnc1_lw1";
		apple,always-on; /* Apple Fabric */
		power-domains = <&ps_afnc1_ls>;
	};

	ps_afnc1_lw2: power-controller@220 {
		compatible = "apple,t6000-pmgr-pwrstate", "apple,pmgr-pwrstate";
		reg = <0x220 4>;
		#power-domain-cells = <0>;
		#reset-cells = <0>;
		label = "afnc1_lw2";
		apple,always-on; /* Apple Fabric */
		power-domains = <&ps_afnc1_ls>;
	};

	ps_afnc0_lw0: power-controller@228 {
		compatible = "apple,t6000-pmgr-pwrstate", "apple,pmgr-pwrstate";
		reg = <0x228 4>;
		#power-domain-cells = <0>;
		#reset-cells = <0>;
		label = "afnc0_lw0";
		apple,always-on; /* Apple Fabric */
		power-domains = <&ps_afnc0_ls>;
	};

	ps_scodec: power-controller@230 {
		compatible = "apple,t6000-pmgr-pwrstate", "apple,pmgr-pwrstate";
		reg = <0x230 4>;
		#power-domain-cells = <0>;
		#reset-cells = <0>;
		label = "scodec";
		power-domains = <&ps_afnc1_lw0>;
	};

	ps_atc0_common: power-controller@238 {
		compatible = "apple,t6000-pmgr-pwrstate", "apple,pmgr-pwrstate";
		reg = <0x238 4>;
		#power-domain-cells = <0>;
		#reset-cells = <0>;
		label = "atc0_common";
		power-domains = <&ps_afnc1_lw1>;
	};

	ps_atc1_common: power-controller@240 {
		compatible = "apple,t6000-pmgr-pwrstate", "apple,pmgr-pwrstate";
		reg = <0x240 4>;
		#power-domain-cells = <0>;
		#reset-cells = <0>;
		label = "atc1_common";
		power-domains = <&ps_afnc1_lw1>;
	};

	ps_c0_usb31drd: power-controller@248 {
		compatible = "apple,t6000-pmgr-pwrstate", "apple,pmgr-pwrstate";
		reg = <0x248 4>;
		#power-domain-cells = <0>;
		#reset-cells = <0>;
		label = "c0_usb31drd";
		power-domains = <&ps_usb>;
	};

	ps_c1_usb31drd: power-controller@250 {
		compatible = "apple,t6000-pmgr-pwrstate", "apple,pmgr-pwrstate";
		reg = <0x250 4>;
		#power-domain-cells = <0>;
		#reset-cells = <0>;
		label = "c1_usb31drd";
		power-domains = <&ps_usb>;
	};

	ps_dispext0_fe: power-controller@258 {
		compatible = "apple,t6000-pmgr-pwrstate", "apple,pmgr-pwrstate";
		reg = <0x258 4>;
		#power-domain-cells = <0>;
		#reset-cells = <0>;
		label = "dispext0_fe";
		power-domains = <&ps_afi>;
	};

	ps_dispext1_fe: power-controller@260 {
		compatible = "apple,t6000-pmgr-pwrstate", "apple,pmgr-pwrstate";
		reg = <0x260 4>;
		#power-domain-cells = <0>;
		#reset-cells = <0>;
		label = "dispext1_fe";
		power-domains = <&ps_afi>;
	};

	ps_ane_sys: power-controller@268 {
		compatible = "apple,t6000-pmgr-pwrstate", "apple,pmgr-pwrstate";
		reg = <0x268 4>;
		#power-domain-cells = <0>;
		#reset-cells = <0>;
		label = "ane_sys";
		power-domains = <&ps_afr>;
	};

	ps_avd_sys: power-controller@270 {
		compatible = "apple,t6000-pmgr-pwrstate", "apple,pmgr-pwrstate";
		reg = <0x270 4>;
		#power-domain-cells = <0>;
		#reset-cells = <0>;
		label = "avd_sys";
		power-domains = <&ps_afr>;
	};

	ps_dispext0_cpu0: power-controller@280 {
		compatible = "apple,t6000-pmgr-pwrstate", "apple,pmgr-pwrstate";
		reg = <0x280 4>;
		#power-domain-cells = <0>;
		#reset-cells = <0>;
		label = "dispext0_cpu0";
		power-domains = <&ps_dispext0_fe>;
	};

	ps_dispext1_cpu0: power-controller@2a8 {
		compatible = "apple,t6000-pmgr-pwrstate", "apple,pmgr-pwrstate";
		reg = <0x2a8 4>;
		#power-domain-cells = <0>;
		#reset-cells = <0>;
		label = "dispext1_cpu0";
		power-domains = <&ps_dispext1_fe>;
	};

	ps_ane_sys_cpu: power-controller@2c8 {
		compatible = "apple,t6000-pmgr-pwrstate", "apple,pmgr-pwrstate";
		reg = <0x2c8 4>;
		#power-domain-cells = <0>;
		#reset-cells = <0>;
		label = "ane_sys_cpu";
		power-domains = <&ps_ane_sys>;
	};

	ps_pmp: power-controller@2d8 {
		compatible = "apple,t6000-pmgr-pwrstate", "apple,pmgr-pwrstate";
		reg = <0x2d8 4>;
		#power-domain-cells = <0>;
		#reset-cells = <0>;
		label = "pmp";
	};

	ps_pms_sram: power-controller@2e0 {
		compatible = "apple,t6000-pmgr-pwrstate", "apple,pmgr-pwrstate";
		reg = <0x2e0 4>;
		#power-domain-cells = <0>;
		#reset-cells = <0>;
		label = "pms_sram";
	};

	ps_apcie_st_sys: power-controller@2e8 {
		compatible = "apple,t6000-pmgr-pwrstate", "apple,pmgr-pwrstate";
		reg = <0x2e8 4>;
		#power-domain-cells = <0>;
		#reset-cells = <0>;
		label = "apcie_st_sys";
		power-domains = <&ps_apcie_st>;
	};

	ps_apcie_st1_sys: power-controller@2f0 {
		compatible = "apple,t6000-pmgr-pwrstate", "apple,pmgr-pwrstate";
		reg = <0x2f0 4>;
		#power-domain-cells = <0>;
		#reset-cells = <0>;
		label = "apcie_st1_sys";
		power-domains = <&ps_apcie_st>;
	};

	ps_atc2_common: power-controller@2f8 {
		compatible = "apple,t6000-pmgr-pwrstate", "apple,pmgr-pwrstate";
		reg = <0x2f8 4>;
		#power-domain-cells = <0>;
		#reset-cells = <0>;
		label = "atc2_common";
		power-domains = <&ps_afnc1_lw1>;
	};

	ps_atc3_common: power-controller@300 {
		compatible = "apple,t6000-pmgr-pwrstate", "apple,pmgr-pwrstate";
		reg = <0x300 4>;
		#power-domain-cells = <0>;
		#reset-cells = <0>;
		label = "atc3_common";
		power-domains = <&ps_afnc1_lw1>;
	};

	ps_usb: power-controller@318 {
		compatible = "apple,t6000-pmgr-pwrstate", "apple,pmgr-pwrstate";
		reg = <0x318 4>;
		#power-domain-cells = <0>;
		#reset-cells = <0>;
		label = "usb";
		power-domains = <&ps_afnc1_lw2>;
	};

	ps_apcie_gp_sys: power-controller@320 {
		compatible = "apple,t6000-pmgr-pwrstate", "apple,pmgr-pwrstate";
		reg = <0x320 4>;
		#power-domain-cells = <0>;
		#reset-cells = <0>;
		label = "apcie_gp_sys";
		power-domains = <&ps_afnc1_lw2>, <&ps_apcie_gp>;
	};

	ps_atc0_cio: power-controller@328 {
		compatible = "apple,t6000-pmgr-pwrstate", "apple,pmgr-pwrstate";
		reg = <0x328 4>;
		#power-domain-cells = <0>;
		#reset-cells = <0>;
		label = "atc0_cio";
		power-domains = <&ps_atc0_common>;
	};

	ps_atc0_pcie: power-controller@330 {
		compatible = "apple,t6000-pmgr-pwrstate", "apple,pmgr-pwrstate";
		reg = <0x330 4>;
		#power-domain-cells = <0>;
		#reset-cells = <0>;
		label = "atc0_pcie";
		power-domains = <&ps_atc0_common>;
	};

	ps_atc1_cio: power-controller@338 {
		compatible = "apple,t6000-pmgr-pwrstate", "apple,pmgr-pwrstate";
		reg = <0x338 4>;
		#power-domain-cells = <0>;
		#reset-cells = <0>;
		label = "atc1_cio";
		power-domains = <&ps_atc1_common>;
	};

	ps_atc1_pcie: power-controller@340 {
		compatible = "apple,t6000-pmgr-pwrstate", "apple,pmgr-pwrstate";
		reg = <0x340 4>;
		#power-domain-cells = <0>;
		#reset-cells = <0>;
		label = "atc1_pcie";
		power-domains = <&ps_atc1_common>;
	};

	ps_atc2_cio: power-controller@348 {
		compatible = "apple,t6000-pmgr-pwrstate", "apple,pmgr-pwrstate";
		reg = <0x348 4>;
		#power-domain-cells = <0>;
		#reset-cells = <0>;
		label = "atc2_cio";
		power-domains = <&ps_atc2_common>;
	};

	ps_atc2_pcie: power-controller@350 {
		compatible = "apple,t6000-pmgr-pwrstate", "apple,pmgr-pwrstate";
		reg = <0x350 4>;
		#power-domain-cells = <0>;
		#reset-cells = <0>;
		label = "atc2_pcie";
		power-domains = <&ps_atc2_common>;
	};

	ps_atc3_cio: power-controller@358 {
		compatible = "apple,t6000-pmgr-pwrstate", "apple,pmgr-pwrstate";
		reg = <0x358 4>;
		#power-domain-cells = <0>;
		#reset-cells = <0>;
		label = "atc3_cio";
		power-domains = <&ps_atc3_common>;
	};

	ps_atc3_pcie: power-controller@360 {
		compatible = "apple,t6000-pmgr-pwrstate", "apple,pmgr-pwrstate";
		reg = <0x360 4>;
		#power-domain-cells = <0>;
		#reset-cells = <0>;
		label = "atc3_pcie";
		power-domains = <&ps_atc3_common>;
	};

	ps_c0_usbctl: power-controller@368 {
		compatible = "apple,t6000-pmgr-pwrstate", "apple,pmgr-pwrstate";
		reg = <0x368 4>;
		#power-domain-cells = <0>;
		#reset-cells = <0>;
		label = "c0_usbctl";
		power-domains = <&ps_usb>;
	};

	ps_c1_usbctl: power-controller@370 {
		compatible = "apple,t6000-pmgr-pwrstate", "apple,pmgr-pwrstate";
		reg = <0x370 4>;
		#power-domain-cells = <0>;
		#reset-cells = <0>;
		label = "c1_usbctl";
		power-domains = <&ps_usb>;
	};

	ps_atc0_cio_pcie: power-controller@378 {
		compatible = "apple,t6000-pmgr-pwrstate", "apple,pmgr-pwrstate";
		reg = <0x378 4>;
		#power-domain-cells = <0>;
		#reset-cells = <0>;
		label = "atc0_cio_pcie";
		power-domains = <&ps_atc0_cio>;
	};

	ps_atc0_cio_usb: power-controller@380 {
		compatible = "apple,t6000-pmgr-pwrstate", "apple,pmgr-pwrstate";
		reg = <0x380 4>;
		#power-domain-cells = <0>;
		#reset-cells = <0>;
		label = "atc0_cio_usb";
		power-domains = <&ps_atc0_cio>;
	};

	ps_atc1_cio_pcie: power-controller@388 {
		compatible = "apple,t6000-pmgr-pwrstate", "apple,pmgr-pwrstate";
		reg = <0x388 4>;
		#power-domain-cells = <0>;
		#reset-cells = <0>;
		label = "atc1_cio_pcie";
		power-domains = <&ps_atc1_cio>;
	};

	ps_atc1_cio_usb: power-controller@390 {
		compatible = "apple,t6000-pmgr-pwrstate", "apple,pmgr-pwrstate";
		reg = <0x390 4>;
		#power-domain-cells = <0>;
		#reset-cells = <0>;
		label = "atc1_cio_usb";
		power-domains = <&ps_atc1_cio>;
	};

	ps_atc2_cio_pcie: power-controller@398 {
		compatible = "apple,t6000-pmgr-pwrstate", "apple,pmgr-pwrstate";
		reg = <0x398 4>;
		#power-domain-cells = <0>;
		#reset-cells = <0>;
		label = "atc2_cio_pcie";
		power-domains = <&ps_atc2_cio>;
	};

	ps_atc2_cio_usb: power-controller@3a0 {
		compatible = "apple,t6000-pmgr-pwrstate", "apple,pmgr-pwrstate";
		reg = <0x3a0 4>;
		#power-domain-cells = <0>;
		#reset-cells = <0>;
		label = "atc2_cio_usb";
		power-domains = <&ps_atc2_cio>;
	};

	ps_atc3_cio_pcie: power-controller@3a8 {
		compatible = "apple,t6000-pmgr-pwrstate", "apple,pmgr-pwrstate";
		reg = <0x3a8 4>;
		#power-domain-cells = <0>;
		#reset-cells = <0>;
		label = "atc3_cio_pcie";
		power-domains = <&ps_atc3_cio>;
	};

	ps_atc3_cio_usb: power-controller@3b0 {
		compatible = "apple,t6000-pmgr-pwrstate", "apple,pmgr-pwrstate";
		reg = <0x3b0 4>;
		#power-domain-cells = <0>;
		#reset-cells = <0>;
		label = "atc3_cio_usb";
		power-domains = <&ps_atc3_cio>;
	};

	ps_trace_fab: power-controller@3b8 {
		compatible = "apple,t6000-pmgr-pwrstate", "apple,pmgr-pwrstate";
		reg = <0x3b8 4>;
		#power-domain-cells = <0>;
		#reset-cells = <0>;
		label = "trace_fab";
	};
};

&pmgr_east {
	ps_clvr_spmi0: power-controller@100 {
		compatible = "apple,t6000-pmgr-pwrstate", "apple,pmgr-pwrstate";
		reg = <0x100 4>;
		#power-domain-cells = <0>;
		#reset-cells = <0>;
		label = "clvr_spmi0";
		apple,always-on; /* PCPU voltage regulator interface (used by SMC) */
	};

	ps_clvr_spmi1: power-controller@108 {
		compatible = "apple,t6000-pmgr-pwrstate", "apple,pmgr-pwrstate";
		reg = <0x108 4>;
		#power-domain-cells = <0>;
		#reset-cells = <0>;
		label = "clvr_spmi1";
		apple,always-on; /* GPU voltage regulator interface (used by SMC) */
	};

	ps_clvr_spmi2: power-controller@110 {
		compatible = "apple,t6000-pmgr-pwrstate", "apple,pmgr-pwrstate";
		reg = <0x110 4>;
		#power-domain-cells = <0>;
		#reset-cells = <0>;
		label = "clvr_spmi2";
		apple,always-on; /* ANE, fabric, AFR voltage regulator interface (used by SMC) */
	};

	ps_clvr_spmi3: power-controller@118 {
		compatible = "apple,t6000-pmgr-pwrstate", "apple,pmgr-pwrstate";
		reg = <0x118 4>;
		#power-domain-cells = <0>;
		#reset-cells = <0>;
		label = "clvr_spmi3";
		apple,always-on; /* Additional voltage regulator, probably used on T6001 (SMC) */
	};

	ps_clvr_spmi4: power-controller@120 {
		compatible = "apple,t6000-pmgr-pwrstate", "apple,pmgr-pwrstate";
		reg = <0x120 4>;
		#power-domain-cells = <0>;
		#reset-cells = <0>;
		label = "clvr_spmi4";
		apple,always-on; /* Additional voltage regulator, probably used on T6001 (SMC) */
	};

	ps_ispsens0: power-controller@128 {
		compatible = "apple,t6000-pmgr-pwrstate", "apple,pmgr-pwrstate";
		reg = <0x128 4>;
		#power-domain-cells = <0>;
		#reset-cells = <0>;
		label = "ispsens0";
	};

	ps_ispsens1: power-controller@130 {
		compatible = "apple,t6000-pmgr-pwrstate", "apple,pmgr-pwrstate";
		reg = <0x130 4>;
		#power-domain-cells = <0>;
		#reset-cells = <0>;
		label = "ispsens1";
	};

	ps_ispsens2: power-controller@138 {
		compatible = "apple,t6000-pmgr-pwrstate", "apple,pmgr-pwrstate";
		reg = <0x138 4>;
		#power-domain-cells = <0>;
		#reset-cells = <0>;
		label = "ispsens2";
	};

	ps_ispsens3: power-controller@140 {
		compatible = "apple,t6000-pmgr-pwrstate", "apple,pmgr-pwrstate";
		reg = <0x140 4>;
		#power-domain-cells = <0>;
		#reset-cells = <0>;
		label = "ispsens3";
	};

	ps_afnc2_ioa: power-controller@148 {
		compatible = "apple,t6000-pmgr-pwrstate", "apple,pmgr-pwrstate";
		reg = <0x148 4>;
		#power-domain-cells = <0>;
		#reset-cells = <0>;
		label = "afnc2_ioa";
		apple,always-on; /* Apple Fabric */
		power-domains = <&ps_afi>;
	};

	ps_afnc2_ls: power-controller@150 {
		compatible = "apple,t6000-pmgr-pwrstate", "apple,pmgr-pwrstate";
		reg = <0x150 4>;
		#power-domain-cells = <0>;
		#reset-cells = <0>;
		label = "afnc2_ls";
		apple,always-on; /* Apple Fabric */
		power-domains = <&ps_afnc2_ioa>;
	};

	ps_afnc2_lw0: power-controller@158 {
		compatible = "apple,t6000-pmgr-pwrstate", "apple,pmgr-pwrstate";
		reg = <0x158 4>;
		#power-domain-cells = <0>;
		#reset-cells = <0>;
		label = "afnc2_lw0";
		apple,always-on; /* Apple Fabric */
		power-domains = <&ps_afnc2_ls>;
	};

	ps_afnc2_lw1: power-controller@160 {
		compatible = "apple,t6000-pmgr-pwrstate", "apple,pmgr-pwrstate";
		reg = <0x160 4>;
		#power-domain-cells = <0>;
		#reset-cells = <0>;
		label = "afnc2_lw1";
		apple,always-on; /* Apple Fabric */
		power-domains = <&ps_afnc2_ls>;
	};

	ps_afnc3_ioa: power-controller@168 {
		compatible = "apple,t6000-pmgr-pwrstate", "apple,pmgr-pwrstate";
		reg = <0x168 4>;
		#power-domain-cells = <0>;
		#reset-cells = <0>;
		label = "afnc3_ioa";
		apple,always-on; /* Apple Fabric */
		power-domains = <&ps_afi>;
	};

	ps_afnc3_ls: power-controller@170 {
		compatible = "apple,t6000-pmgr-pwrstate", "apple,pmgr-pwrstate";
		reg = <0x170 4>;
		#power-domain-cells = <0>;
		#reset-cells = <0>;
		label = "afnc3_ls";
		apple,always-on; /* Apple Fabric */
		power-domains = <&ps_afnc3_ioa>;
	};

	ps_afnc3_lw0: power-controller@178 {
		compatible = "apple,t6000-pmgr-pwrstate", "apple,pmgr-pwrstate";
		reg = <0x178 4>;
		#power-domain-cells = <0>;
		#reset-cells = <0>;
		label = "afnc3_lw0";
		apple,always-on; /* Apple Fabric */
		power-domains = <&ps_afnc3_ls>;
	};

	ps_sio: power-controller@180 {
		compatible = "apple,t6000-pmgr-pwrstate", "apple,pmgr-pwrstate";
		reg = <0x180 4>;
		#power-domain-cells = <0>;
		#reset-cells = <0>;
		label = "sio";
		power-domains = <&ps_afnc2_lw1>;
	};

	ps_sio_cpu: power-controller@188 {
		compatible = "apple,t6000-pmgr-pwrstate", "apple,pmgr-pwrstate";
		reg = <0x188 4>;
		#power-domain-cells = <0>;
		#reset-cells = <0>;
		label = "sio_cpu";
		power-domains = <&ps_sio>;
	};

	ps_fpwm0: power-controller@190 {
		compatible = "apple,t6000-pmgr-pwrstate", "apple,pmgr-pwrstate";
		reg = <0x190 4>;
		#power-domain-cells = <0>;
		#reset-cells = <0>;
		label = "fpwm0";
		power-domains = <&ps_sio>;
	};

	ps_fpwm1: power-controller@198 {
		compatible = "apple,t6000-pmgr-pwrstate", "apple,pmgr-pwrstate";
		reg = <0x198 4>;
		#power-domain-cells = <0>;
		#reset-cells = <0>;
		label = "fpwm1";
		power-domains = <&ps_sio>;
	};

	ps_fpwm2: power-controller@1a0 {
		compatible = "apple,t6000-pmgr-pwrstate", "apple,pmgr-pwrstate";
		reg = <0x1a0 4>;
		#power-domain-cells = <0>;
		#reset-cells = <0>;
		label = "fpwm2";
		power-domains = <&ps_sio>;
	};

	ps_i2c0: power-controller@1a8 {
		compatible = "apple,t6000-pmgr-pwrstate", "apple,pmgr-pwrstate";
		reg = <0x1a8 4>;
		#power-domain-cells = <0>;
		#reset-cells = <0>;
		label = "i2c0";
		power-domains = <&ps_sio>;
	};

	ps_i2c1: power-controller@1b0 {
		compatible = "apple,t6000-pmgr-pwrstate", "apple,pmgr-pwrstate";
		reg = <0x1b0 4>;
		#power-domain-cells = <0>;
		#reset-cells = <0>;
		label = "i2c1";
		power-domains = <&ps_sio>;
	};

	ps_i2c2: power-controller@1b8 {
		compatible = "apple,t6000-pmgr-pwrstate", "apple,pmgr-pwrstate";
		reg = <0x1b8 4>;
		#power-domain-cells = <0>;
		#reset-cells = <0>;
		label = "i2c2";
		power-domains = <&ps_sio>;
	};

	ps_i2c3: power-controller@1c0 {
		compatible = "apple,t6000-pmgr-pwrstate", "apple,pmgr-pwrstate";
		reg = <0x1c0 4>;
		#power-domain-cells = <0>;
		#reset-cells = <0>;
		label = "i2c3";
		power-domains = <&ps_sio>;
	};

	ps_i2c4: power-controller@1c8 {
		compatible = "apple,t6000-pmgr-pwrstate", "apple,pmgr-pwrstate";
		reg = <0x1c8 4>;
		#power-domain-cells = <0>;
		#reset-cells = <0>;
		label = "i2c4";
		power-domains = <&ps_sio>;
	};

	ps_i2c5: power-controller@1d0 {
		compatible = "apple,t6000-pmgr-pwrstate", "apple,pmgr-pwrstate";
		reg = <0x1d0 4>;
		#power-domain-cells = <0>;
		#reset-cells = <0>;
		label = "i2c5";
		power-domains = <&ps_sio>;
	};

	ps_i2c6: power-controller@1d8 {
		compatible = "apple,t6000-pmgr-pwrstate", "apple,pmgr-pwrstate";
		reg = <0x1d8 4>;
		#power-domain-cells = <0>;
		#reset-cells = <0>;
		label = "i2c6";
		power-domains = <&ps_sio>;
	};

	ps_i2c7: power-controller@1e0 {
		compatible = "apple,t6000-pmgr-pwrstate", "apple,pmgr-pwrstate";
		reg = <0x1e0 4>;
		#power-domain-cells = <0>;
		#reset-cells = <0>;
		label = "i2c7";
		power-domains = <&ps_sio>;
	};

	ps_spi_p: power-controller@1e8 {
		compatible = "apple,t6000-pmgr-pwrstate", "apple,pmgr-pwrstate";
		reg = <0x1e8 4>;
		#power-domain-cells = <0>;
		#reset-cells = <0>;
		label = "spi_p";
		power-domains = <&ps_sio>;
	};

	ps_spi0: power-controller@1f0 {
		compatible = "apple,t6000-pmgr-pwrstate", "apple,pmgr-pwrstate";
		reg = <0x1f0 4>;
		#power-domain-cells = <0>;
		#reset-cells = <0>;
		label = "spi0";
		power-domains = <&ps_spi_p>;
	};

	ps_spi1: power-controller@1f8 {
		compatible = "apple,t6000-pmgr-pwrstate", "apple,pmgr-pwrstate";
		reg = <0x1f8 4>;
		#power-domain-cells = <0>;
		#reset-cells = <0>;
		label = "spi1";
		power-domains = <&ps_spi_p>;
	};

	ps_spi2: power-controller@200 {
		compatible = "apple,t6000-pmgr-pwrstate", "apple,pmgr-pwrstate";
		reg = <0x200 4>;
		#power-domain-cells = <0>;
		#reset-cells = <0>;
		label = "spi2";
		power-domains = <&ps_spi_p>;
	};

	ps_spi3: power-controller@208 {
		compatible = "apple,t6000-pmgr-pwrstate", "apple,pmgr-pwrstate";
		reg = <0x208 4>;
		#power-domain-cells = <0>;
		#reset-cells = <0>;
		label = "spi3";
		power-domains = <&ps_spi_p>;
	};

	ps_spi4: power-controller@210 {
		compatible = "apple,t6000-pmgr-pwrstate", "apple,pmgr-pwrstate";
		reg = <0x210 4>;
		#power-domain-cells = <0>;
		#reset-cells = <0>;
		label = "spi4";
		power-domains = <&ps_spi_p>;
	};

	ps_sio_spmi0: power-controller@218 {
		compatible = "apple,t6000-pmgr-pwrstate", "apple,pmgr-pwrstate";
		reg = <0x218 4>;
		#power-domain-cells = <0>;
		#reset-cells = <0>;
		label = "sio_spmi0";
		power-domains = <&ps_sio>;
	};

	ps_sio_spmi1: power-controller@220 {
		compatible = "apple,t6000-pmgr-pwrstate", "apple,pmgr-pwrstate";
		reg = <0x220 4>;
		#power-domain-cells = <0>;
		#reset-cells = <0>;
		label = "sio_spmi1";
		power-domains = <&ps_sio>;
	};

	ps_sio_spmi2: power-controller@228 {
		compatible = "apple,t6000-pmgr-pwrstate", "apple,pmgr-pwrstate";
		reg = <0x228 4>;
		#power-domain-cells = <0>;
		#reset-cells = <0>;
		label = "sio_spmi2";
		power-domains = <&ps_sio>;
	};

	ps_uart_p: power-controller@230 {
		compatible = "apple,t6000-pmgr-pwrstate", "apple,pmgr-pwrstate";
		reg = <0x230 4>;
		#power-domain-cells = <0>;
		#reset-cells = <0>;
		label = "uart_p";
		power-domains = <&ps_sio>;
	};

	ps_uart_n: power-controller@238 {
		compatible = "apple,t6000-pmgr-pwrstate", "apple,pmgr-pwrstate";
		reg = <0x238 4>;
		#power-domain-cells = <0>;
		#reset-cells = <0>;
		label = "uart_n";
		power-domains = <&ps_uart_p>;
	};

	ps_uart0: power-controller@240 {
		compatible = "apple,t6000-pmgr-pwrstate", "apple,pmgr-pwrstate";
		reg = <0x240 4>;
		#power-domain-cells = <0>;
		#reset-cells = <0>;
		label = "uart0";
		power-domains = <&ps_uart_p>;
	};

	ps_uart1: power-controller@248 {
		compatible = "apple,t6000-pmgr-pwrstate", "apple,pmgr-pwrstate";
		reg = <0x248 4>;
		#power-domain-cells = <0>;
		#reset-cells = <0>;
		label = "uart1";
		power-domains = <&ps_uart_p>;
	};

	ps_uart2: power-controller@250 {
		compatible = "apple,t6000-pmgr-pwrstate", "apple,pmgr-pwrstate";
		reg = <0x250 4>;
		#power-domain-cells = <0>;
		#reset-cells = <0>;
		label = "uart2";
		power-domains = <&ps_uart_p>;
	};

	ps_uart3: power-controller@258 {
		compatible = "apple,t6000-pmgr-pwrstate", "apple,pmgr-pwrstate";
		reg = <0x258 4>;
		#power-domain-cells = <0>;
		#reset-cells = <0>;
		label = "uart3";
		power-domains = <&ps_uart_p>;
	};

	ps_uart4: power-controller@260 {
		compatible = "apple,t6000-pmgr-pwrstate", "apple,pmgr-pwrstate";
		reg = <0x260 4>;
		#power-domain-cells = <0>;
		#reset-cells = <0>;
		label = "uart4";
		power-domains = <&ps_uart_p>;
	};

	ps_uart6: power-controller@268 {
		compatible = "apple,t6000-pmgr-pwrstate", "apple,pmgr-pwrstate";
		reg = <0x268 4>;
		#power-domain-cells = <0>;
		#reset-cells = <0>;
		label = "uart6";
		power-domains = <&ps_uart_p>;
	};

	ps_uart7: power-controller@270 {
		compatible = "apple,t6000-pmgr-pwrstate", "apple,pmgr-pwrstate";
		reg = <0x270 4>;
		#power-domain-cells = <0>;
		#reset-cells = <0>;
		label = "uart7";
		power-domains = <&ps_uart_p>;
	};

	ps_audio_p: power-controller@278 {
		compatible = "apple,t6000-pmgr-pwrstate", "apple,pmgr-pwrstate";
		reg = <0x278 4>;
		#power-domain-cells = <0>;
		#reset-cells = <0>;
		label = "audio_p";
		power-domains = <&ps_sio>;
	};

	ps_sio_adma: power-controller@280 {
		compatible = "apple,t6000-pmgr-pwrstate", "apple,pmgr-pwrstate";
		reg = <0x280 4>;
		#power-domain-cells = <0>;
		#reset-cells = <0>;
		label = "sio_adma";
		power-domains = <&ps_audio_p>, <&ps_sio>;
	};

	ps_mca0: power-controller@288 {
		compatible = "apple,t6000-pmgr-pwrstate", "apple,pmgr-pwrstate";
		reg = <0x288 4>;
		#power-domain-cells = <0>;
		#reset-cells = <0>;
		label = "mca0";
		power-domains = <&ps_audio_p>, <&ps_sio_adma>;
	};

	ps_mca1: power-controller@290 {
		compatible = "apple,t6000-pmgr-pwrstate", "apple,pmgr-pwrstate";
		reg = <0x290 4>;
		#power-domain-cells = <0>;
		#reset-cells = <0>;
		label = "mca1";
		power-domains = <&ps_audio_p>, <&ps_sio_adma>;
	};

	ps_mca2: power-controller@298 {
		compatible = "apple,t6000-pmgr-pwrstate", "apple,pmgr-pwrstate";
		reg = <0x298 4>;
		#power-domain-cells = <0>;
		#reset-cells = <0>;
		label = "mca2";
		power-domains = <&ps_audio_p>, <&ps_sio_adma>;
	};

	ps_mca3: power-controller@2a0 {
		compatible = "apple,t6000-pmgr-pwrstate", "apple,pmgr-pwrstate";
		reg = <0x2a0 4>;
		#power-domain-cells = <0>;
		#reset-cells = <0>;
		label = "mca3";
		power-domains = <&ps_audio_p>, <&ps_sio_adma>;
	};

	ps_dpa0: power-controller@2a8 {
		compatible = "apple,t6000-pmgr-pwrstate", "apple,pmgr-pwrstate";
		reg = <0x2a8 4>;
		#power-domain-cells = <0>;
		#reset-cells = <0>;
		label = "dpa0";
		power-domains = <&ps_audio_p>;
	};

	ps_dpa1: power-controller@2b0 {
		compatible = "apple,t6000-pmgr-pwrstate", "apple,pmgr-pwrstate";
		reg = <0x2b0 4>;
		#power-domain-cells = <0>;
		#reset-cells = <0>;
		label = "dpa1";
		power-domains = <&ps_audio_p>;
	};

	ps_dpa2: power-controller@2b8 {
		compatible = "apple,t6000-pmgr-pwrstate", "apple,pmgr-pwrstate";
		reg = <0x2b8 4>;
		#power-domain-cells = <0>;
		#reset-cells = <0>;
		label = "dpa2";
		power-domains = <&ps_audio_p>;
	};

	ps_dpa3: power-controller@2c0 {
		compatible = "apple,t6000-pmgr-pwrstate", "apple,pmgr-pwrstate";
		reg = <0x2c0 4>;
		#power-domain-cells = <0>;
		#reset-cells = <0>;
		label = "dpa3";
		power-domains = <&ps_audio_p>;
	};

	ps_dpa4: power-controller@2c8 {
		compatible = "apple,t6000-pmgr-pwrstate", "apple,pmgr-pwrstate";
		reg = <0x2c8 4>;
		#power-domain-cells = <0>;
		#reset-cells = <0>;
		label = "dpa4";
		power-domains = <&ps_audio_p>;
	};

	ps_aes: power-controller@2d0 {
		compatible = "apple,t6000-pmgr-pwrstate", "apple,pmgr-pwrstate";
		reg = <0x2d0 4>;
		#power-domain-cells = <0>;
		#reset-cells = <0>;
		label = "aes";
		power-domains = <&ps_sio>;
	};

	ps_amcc1: power-controller@2d8 {
		compatible = "apple,t6000-pmgr-pwrstate", "apple,pmgr-pwrstate";
		reg = <0x2d8 4>;
		#power-domain-cells = <0>;
		#reset-cells = <0>;
		label = "amcc1";
		apple,always-on; /* Memory controller */
	};

	ps_amcc3: power-controller@2e0 {
		compatible = "apple,t6000-pmgr-pwrstate", "apple,pmgr-pwrstate";
		reg = <0x2e0 4>;
		#power-domain-cells = <0>;
		#reset-cells = <0>;
		label = "amcc3";
		apple,always-on; /* Memory controller */
	};

	ps_dcs_04: power-controller@2e8 {
		compatible = "apple,t6000-pmgr-pwrstate", "apple,pmgr-pwrstate";
		reg = <0x2e8 4>;
		#power-domain-cells = <0>;
		#reset-cells = <0>;
		label = "dcs_04";
		apple,always-on; /* LPDDR5 interface */
	};

	ps_dcs_05: power-controller@2f0 {
		compatible = "apple,t6000-pmgr-pwrstate", "apple,pmgr-pwrstate";
		reg = <0x2f0 4>;
		#power-domain-cells = <0>;
		#reset-cells = <0>;
		label = "dcs_05";
		apple,always-on; /* LPDDR5 interface */
	};

	ps_dcs_06: power-controller@2f8 {
		compatible = "apple,t6000-pmgr-pwrstate", "apple,pmgr-pwrstate";
		reg = <0x2f8 4>;
		#power-domain-cells = <0>;
		#reset-cells = <0>;
		label = "dcs_06";
		apple,always-on; /* LPDDR5 interface */
	};

	ps_dcs_07: power-controller@300 {
		compatible = "apple,t6000-pmgr-pwrstate", "apple,pmgr-pwrstate";
		reg = <0x300 4>;
		#power-domain-cells = <0>;
		#reset-cells = <0>;
		label = "dcs_07";
		apple,always-on; /* LPDDR5 interface */
	};

	ps_dcs_12: power-controller@308 {
		compatible = "apple,t6000-pmgr-pwrstate", "apple,pmgr-pwrstate";
		reg = <0x308 4>;
		#power-domain-cells = <0>;
		#reset-cells = <0>;
		label = "dcs_12";
		apple,always-on; /* LPDDR5 interface */
	};

	ps_dcs_13: power-controller@310 {
		compatible = "apple,t6000-pmgr-pwrstate", "apple,pmgr-pwrstate";
		reg = <0x310 4>;
		#power-domain-cells = <0>;
		#reset-cells = <0>;
		label = "dcs_13";
		apple,always-on; /* LPDDR5 interface */
	};

	ps_dcs_14: power-controller@318 {
		compatible = "apple,t6000-pmgr-pwrstate", "apple,pmgr-pwrstate";
		reg = <0x318 4>;
		#power-domain-cells = <0>;
		#reset-cells = <0>;
		label = "dcs_14";
		apple,always-on; /* LPDDR5 interface */
	};

	ps_dcs_15: power-controller@320 {
		compatible = "apple,t6000-pmgr-pwrstate", "apple,pmgr-pwrstate";
		reg = <0x320 4>;
		#power-domain-cells = <0>;
		#reset-cells = <0>;
		label = "dcs_15";
		apple,always-on; /* LPDDR5 interface */
	};

	ps_disp0_fe: power-controller@328 {
		compatible = "apple,t6000-pmgr-pwrstate", "apple,pmgr-pwrstate";
		reg = <0x328 4>;
		#power-domain-cells = <0>;
		#reset-cells = <0>;
		label = "disp0_fe";
		power-domains = <&ps_afnc2_lw0>;
		apple,always-on; /* TODO: figure out if we can enable PM here */
	};

	ps_disp0_cpu0: power-controller@350 {
		compatible = "apple,t6000-pmgr-pwrstate", "apple,pmgr-pwrstate";
		reg = <0x350 4>;
		#power-domain-cells = <0>;
		#reset-cells = <0>;
		label = "disp0_cpu0";
		power-domains = <&ps_disp0_fe>;
		apple,always-on; /* TODO: figure out if we can enable PM here */
	};

	ps_dispdfr_fe: power-controller@378 {
		compatible = "apple,t6000-pmgr-pwrstate", "apple,pmgr-pwrstate";
		reg = <0x378 4>;
		#power-domain-cells = <0>;
		#reset-cells = <0>;
		label = "dispdfr_fe";
		power-domains = <&ps_afnc2_lw1>;
	};

	ps_dispdfr_be: power-controller@380 {
		compatible = "apple,t6000-pmgr-pwrstate", "apple,pmgr-pwrstate";
		reg = <0x380 4>;
		#power-domain-cells = <0>;
		#reset-cells = <0>;
		label = "dispdfr_be";
		power-domains = <&ps_dispdfr_fe>;
	};

	ps_mipi_dsi: power-controller@388 {
		compatible = "apple,t6000-pmgr-pwrstate", "apple,pmgr-pwrstate";
		reg = <0x388 4>;
		#power-domain-cells = <0>;
		#reset-cells = <0>;
		label = "mipi_dsi";
		power-domains = <&ps_dispdfr_be>;
	};

	ps_jpg: power-controller@390 {
		compatible = "apple,t6000-pmgr-pwrstate", "apple,pmgr-pwrstate";
		reg = <0x390 4>;
		#power-domain-cells = <0>;
		#reset-cells = <0>;
		label = "jpg";
		power-domains = <&ps_afr>;
	};

	ps_msr0: power-controller@398 {
		compatible = "apple,t6000-pmgr-pwrstate", "apple,pmgr-pwrstate";
		reg = <0x398 4>;
		#power-domain-cells = <0>;
		#reset-cells = <0>;
		label = "msr0";
		power-domains = <&ps_afr>;
	};

	ps_msr0_ase_core: power-controller@3a0 {
		compatible = "apple,t6000-pmgr-pwrstate", "apple,pmgr-pwrstate";
		reg = <0x3a0 4>;
		#power-domain-cells = <0>;
		#reset-cells = <0>;
		label = "msr0_ase_core";
		power-domains = <&ps_msr0>;
	};

	ps_isp_sys: power-controller@3a8 {
		compatible = "apple,t6000-pmgr-pwrstate", "apple,pmgr-pwrstate";
		reg = <0x3a8 4>;
		#power-domain-cells = <0>;
		#reset-cells = <0>;
		label = "isp_sys";
		power-domains = <&ps_afnc2_lw1>;
	};

	ps_venc_sys: power-controller@3b0 {
		compatible = "apple,t6000-pmgr-pwrstate", "apple,pmgr-pwrstate";
		reg = <0x3b0 4>;
		#power-domain-cells = <0>;
		#reset-cells = <0>;
		label = "venc_sys";
		power-domains = <&ps_afr>;
	};

	ps_ans2: power-controller@3b8 {
		compatible = "apple,t6000-pmgr-pwrstate", "apple,pmgr-pwrstate";
		reg = <0x3b8 4>;
		#power-domain-cells = <0>;
		#reset-cells = <0>;
		label = "ans2";
		/*
		 * The ADT makes ps_apcie_st[1]_sys depend on ps_ans2 instead,
		 * but we'd rather have a single power domain for the downstream
		 * device to depend on, so use this node as the child.
		 * This makes more sense anyway (since ANS2 uses APCIE_ST).
		 */
		power-domains = <&ps_afnc2_lw0>, <&ps_apcie_st_sys>, <&ps_apcie_st1_sys>;
	};

	ps_gfx: power-controller@3c0 {
		compatible = "apple,t6000-pmgr-pwrstate", "apple,pmgr-pwrstate";
		reg = <0x3c0 4>;
		#power-domain-cells = <0>;
		#reset-cells = <0>;
		label = "gfx";
		power-domains = <&ps_afr>;
	};

	ps_sep: power-controller@c00 {
		compatible = "apple,t6000-pmgr-pwrstate", "apple,pmgr-pwrstate";
		reg = <0xc00 4>;
		#power-domain-cells = <0>;
		#reset-cells = <0>;
		label = "sep";
		apple,always-on; /* Locked on */
	};

	ps_venc_dma: power-controller@8000 {
		compatible = "apple,t6000-pmgr-pwrstate", "apple,pmgr-pwrstate";
		reg = <0x8000 4>;
		#power-domain-cells = <0>;
		#reset-cells = <0>;
		label = "venc_dma";
		power-domains = <&ps_venc_sys>;
	};

	ps_venc_pipe4: power-controller@8008 {
		compatible = "apple,t6000-pmgr-pwrstate", "apple,pmgr-pwrstate";
		reg = <0x8008 4>;
		#power-domain-cells = <0>;
		#reset-cells = <0>;
		label = "venc_pipe4";
		power-domains = <&ps_venc_dma>;
	};

	ps_venc_pipe5: power-controller@8010 {
		compatible = "apple,t6000-pmgr-pwrstate", "apple,pmgr-pwrstate";
		reg = <0x8010 4>;
		#power-domain-cells = <0>;
		#reset-cells = <0>;
		label = "venc_pipe5";
		power-domains = <&ps_venc_dma>;
	};

	ps_venc_me0: power-controller@8018 {
		compatible = "apple,t6000-pmgr-pwrstate", "apple,pmgr-pwrstate";
		reg = <0x8018 4>;
		#power-domain-cells = <0>;
		#reset-cells = <0>;
		label = "venc_me0";
		power-domains = <&ps_venc_pipe5>, <&ps_venc_pipe4>;
	};

	ps_venc_me1: power-controller@8020 {
		compatible = "apple,t6000-pmgr-pwrstate", "apple,pmgr-pwrstate";
		reg = <0x8020 4>;
		#power-domain-cells = <0>;
		#reset-cells = <0>;
		label = "venc_me1";
		power-domains = <&ps_venc_me0>;
	};
};

&pmgr_south {
	ps_amcc4: power-controller@100 {
		compatible = "apple,t6000-pmgr-pwrstate", "apple,pmgr-pwrstate";
		reg = <0x100 4>;
		#power-domain-cells = <0>;
		#reset-cells = <0>;
		label = "amcc4";
		apple,always-on; /* Memory controller */
	};

	ps_amcc5: power-controller@108 {
		compatible = "apple,t6000-pmgr-pwrstate", "apple,pmgr-pwrstate";
		reg = <0x108 4>;
		#power-domain-cells = <0>;
		#reset-cells = <0>;
		label = "amcc5";
		apple,always-on; /* Memory controller */
	};

	ps_amcc6: power-controller@110 {
		compatible = "apple,t6000-pmgr-pwrstate", "apple,pmgr-pwrstate";
		reg = <0x110 4>;
		#power-domain-cells = <0>;
		#reset-cells = <0>;
		label = "amcc6";
		apple,always-on; /* Memory controller */
	};

	ps_amcc7: power-controller@118 {
		compatible = "apple,t6000-pmgr-pwrstate", "apple,pmgr-pwrstate";
		reg = <0x118 4>;
		#power-domain-cells = <0>;
		#reset-cells = <0>;
		label = "amcc7";
		apple,always-on; /* Memory controller */
	};

	ps_dcs_16: power-controller@120 {
		compatible = "apple,t6000-pmgr-pwrstate", "apple,pmgr-pwrstate";
		reg = <0x120 4>;
		#power-domain-cells = <0>;
		#reset-cells = <0>;
		label = "dcs_16";
		apple,always-on; /* LPDDR5 interface */
	};

	ps_dcs_17: power-controller@128 {
		compatible = "apple,t6000-pmgr-pwrstate", "apple,pmgr-pwrstate";
		reg = <0x128 4>;
		#power-domain-cells = <0>;
		#reset-cells = <0>;
		label = "dcs_17";
		apple,always-on; /* LPDDR5 interface */
	};

	ps_dcs_18: power-controller@130 {
		compatible = "apple,t6000-pmgr-pwrstate", "apple,pmgr-pwrstate";
		reg = <0x130 4>;
		#power-domain-cells = <0>;
		#reset-cells = <0>;
		label = "dcs_18";
		apple,always-on; /* LPDDR5 interface */
	};

	ps_dcs_19: power-controller@138 {
		compatible = "apple,t6000-pmgr-pwrstate", "apple,pmgr-pwrstate";
		reg = <0x138 4>;
		#power-domain-cells = <0>;
		#reset-cells = <0>;
		label = "dcs_19";
		apple,always-on; /* LPDDR5 interface */
	};

	ps_dcs_20: power-controller@140 {
		compatible = "apple,t6000-pmgr-pwrstate", "apple,pmgr-pwrstate";
		reg = <0x140 4>;
		#power-domain-cells = <0>;
		#reset-cells = <0>;
		label = "dcs_20";
		apple,always-on; /* LPDDR5 interface */
	};

	ps_dcs_21: power-controller@148 {
		compatible = "apple,t6000-pmgr-pwrstate", "apple,pmgr-pwrstate";
		reg = <0x148 4>;
		#power-domain-cells = <0>;
		#reset-cells = <0>;
		label = "dcs_21";
		apple,always-on; /* LPDDR5 interface */
	};

	ps_dcs_22: power-controller@150 {
		compatible = "apple,t6000-pmgr-pwrstate", "apple,pmgr-pwrstate";
		reg = <0x150 4>;
		#power-domain-cells = <0>;
		#reset-cells = <0>;
		label = "dcs_22";
		apple,always-on; /* LPDDR5 interface */
	};

	ps_dcs_23: power-controller@158 {
		compatible = "apple,t6000-pmgr-pwrstate", "apple,pmgr-pwrstate";
		reg = <0x158 4>;
		#power-domain-cells = <0>;
		#reset-cells = <0>;
		label = "dcs_23";
		apple,always-on; /* LPDDR5 interface */
	};

	ps_dcs_24: power-controller@160 {
		compatible = "apple,t6000-pmgr-pwrstate", "apple,pmgr-pwrstate";
		reg = <0x160 4>;
		#power-domain-cells = <0>;
		#reset-cells = <0>;
		label = "dcs_24";
		apple,always-on; /* LPDDR5 interface */
	};

	ps_dcs_25: power-controller@168 {
		compatible = "apple,t6000-pmgr-pwrstate", "apple,pmgr-pwrstate";
		reg = <0x168 4>;
		#power-domain-cells = <0>;
		#reset-cells = <0>;
		label = "dcs_25";
		apple,always-on; /* LPDDR5 interface */
	};

	ps_dcs_26: power-controller@170 {
		compatible = "apple,t6000-pmgr-pwrstate", "apple,pmgr-pwrstate";
		reg = <0x170 4>;
		#power-domain-cells = <0>;
		#reset-cells = <0>;
		label = "dcs_26";
		apple,always-on; /* LPDDR5 interface */
	};

	ps_dcs_27: power-controller@178 {
		compatible = "apple,t6000-pmgr-pwrstate", "apple,pmgr-pwrstate";
		reg = <0x178 4>;
		#power-domain-cells = <0>;
		#reset-cells = <0>;
		label = "dcs_27";
		apple,always-on; /* LPDDR5 interface */
	};

	ps_dcs_28: power-controller@180 {
		compatible = "apple,t6000-pmgr-pwrstate", "apple,pmgr-pwrstate";
		reg = <0x180 4>;
		#power-domain-cells = <0>;
		#reset-cells = <0>;
		label = "dcs_28";
		apple,always-on; /* LPDDR5 interface */
	};

	ps_dcs_29: power-controller@188 {
		compatible = "apple,t6000-pmgr-pwrstate", "apple,pmgr-pwrstate";
		reg = <0x188 4>;
		#power-domain-cells = <0>;
		#reset-cells = <0>;
		label = "dcs_29";
		apple,always-on; /* LPDDR5 interface */
	};

	ps_dcs_30: power-controller@190 {
		compatible = "apple,t6000-pmgr-pwrstate", "apple,pmgr-pwrstate";
		reg = <0x190 4>;
		#power-domain-cells = <0>;
		#reset-cells = <0>;
		label = "dcs_30";
		apple,always-on; /* LPDDR5 interface */
	};

	ps_dcs_31: power-controller@198 {
		compatible = "apple,t6000-pmgr-pwrstate", "apple,pmgr-pwrstate";
		reg = <0x198 4>;
		#power-domain-cells = <0>;
		#reset-cells = <0>;
		label = "dcs_31";
		apple,always-on; /* LPDDR5 interface */
	};

	ps_afnc4_ioa: power-controller@1a0 {
		compatible = "apple,t6000-pmgr-pwrstate", "apple,pmgr-pwrstate";
		reg = <0x1a0 4>;
		#power-domain-cells = <0>;
		#reset-cells = <0>;
		label = "afnc4_ioa";
		apple,always-on; /* Apple Fabric */
		power-domains = <&ps_afi>;
	};

	ps_afnc4_ls: power-controller@1a8 {
		compatible = "apple,t6000-pmgr-pwrstate", "apple,pmgr-pwrstate";
		reg = <0x1a8 4>;
		#power-domain-cells = <0>;
		#reset-cells = <0>;
		label = "afnc4_ls";
		apple,always-on; /* Apple Fabric */
		power-domains = <&ps_afnc4_ioa>;
	};

	ps_afnc4_lw0: power-controller@1b0 {
		compatible = "apple,t6000-pmgr-pwrstate", "apple,pmgr-pwrstate";
		reg = <0x1b0 4>;
		#power-domain-cells = <0>;
		#reset-cells = <0>;
		label = "afnc4_lw0";
		apple,always-on; /* Apple Fabric */
		power-domains = <&ps_afnc4_ls>;
	};

	ps_afnc5_ioa: power-controller@1b8 {
		compatible = "apple,t6000-pmgr-pwrstate", "apple,pmgr-pwrstate";
		reg = <0x1b8 4>;
		#power-domain-cells = <0>;
		#reset-cells = <0>;
		label = "afnc5_ioa";
		apple,always-on; /* Apple Fabric */
		power-domains = <&ps_afi>;
	};

	ps_afnc5_ls: power-controller@1c0 {
		compatible = "apple,t6000-pmgr-pwrstate", "apple,pmgr-pwrstate";
		reg = <0x1c0 4>;
		#power-domain-cells = <0>;
		#reset-cells = <0>;
		label = "afnc5_ls";
		apple,always-on; /* Apple Fabric */
		power-domains = <&ps_afnc5_ioa>;
	};

	ps_afnc5_lw0: power-controller@1c8 {
		compatible = "apple,t6000-pmgr-pwrstate", "apple,pmgr-pwrstate";
		reg = <0x1c8 4>;
		#power-domain-cells = <0>;
		#reset-cells = <0>;
		label = "afnc5_lw0";
		apple,always-on; /* Apple Fabric */
		power-domains = <&ps_afnc5_ls>;
	};

	ps_dispext2_fe: power-controller@1d0 {
		compatible = "apple,t6000-pmgr-pwrstate", "apple,pmgr-pwrstate";
		reg = <0x1d0 4>;
		#power-domain-cells = <0>;
		#reset-cells = <0>;
		label = "dispext2_fe";
		power-domains = <&ps_afnc4_lw0>;
	};

	ps_dispext2_cpu0: power-controller@1e8 {
		compatible = "apple,t6000-pmgr-pwrstate", "apple,pmgr-pwrstate";
		reg = <0x1e8 4>;
		#power-domain-cells = <0>;
		#reset-cells = <0>;
		label = "dispext2_cpu0";
		power-domains = <&ps_dispext2_fe>;
	};

	ps_dispext3_fe: power-controller@210 {
		compatible = "apple,t6000-pmgr-pwrstate", "apple,pmgr-pwrstate";
		reg = <0x210 4>;
		#power-domain-cells = <0>;
		#reset-cells = <0>;
		label = "dispext3_fe";
		power-domains = <&ps_afnc4_lw0>;
	};

	ps_dispext3_cpu0: power-controller@228 {
		compatible = "apple,t6000-pmgr-pwrstate", "apple,pmgr-pwrstate";
		reg = <0x228 4>;
		#power-domain-cells = <0>;
		#reset-cells = <0>;
		label = "dispext3_cpu0";
		power-domains = <&ps_dispext3_fe>;
	};

	ps_msr1: power-controller@250 {
		compatible = "apple,t6000-pmgr-pwrstate", "apple,pmgr-pwrstate";
		reg = <0x250 4>;
		#power-domain-cells = <0>;
		#reset-cells = <0>;
		label = "msr1";
		power-domains = <&ps_afnc5_lw0>, <&ps_afr>;
	};

	ps_msr1_ase_core: power-controller@258 {
		compatible = "apple,t6000-pmgr-pwrstate", "apple,pmgr-pwrstate";
		reg = <0x258 4>;
		#power-domain-cells = <0>;
		#reset-cells = <0>;
		label = "msr1_ase_core";
		power-domains = <&ps_msr1>;
	};

	ps_venc1_sys: power-controller@260 {
		compatible = "apple,t6000-pmgr-pwrstate", "apple,pmgr-pwrstate";
		reg = <0x260 4>;
		#power-domain-cells = <0>;
		#reset-cells = <0>;
		label = "venc1_sys";
		power-domains = <&ps_afnc5_lw0>, <&ps_afr>;
	};

	/* Seems to be disabled on shipping hardware */
#if 0
	ps_ane1_sys: power-controller@268 {
		compatible = "apple,t6000-pmgr-pwrstate", "apple,pmgr-pwrstate";
		reg = <0x268 4>;
		#power-domain-cells = <0>;
		#reset-cells = <0>;
		label = "ane1_sys";
		power-domains = <&ps_afnc5_lw0>;
	};

	ps_ane1_sys_cpu: power-controller@270 {
		compatible = "apple,t6000-pmgr-pwrstate", "apple,pmgr-pwrstate";
		reg = <0x270 4>;
		#power-domain-cells = <0>;
		#reset-cells = <0>;
		label = "ane1_sys_cpu";
		power-domains = <&ps_ane1_sys>;
	};
#endif

	ps_venc1_dma: power-controller@8000 {
		compatible = "apple,t6000-pmgr-pwrstate", "apple,pmgr-pwrstate";
		reg = <0x8000 4>;
		#power-domain-cells = <0>;
		#reset-cells = <0>;
		label = "venc1_dma";
		power-domains = <&ps_venc1_sys>;
	};

	ps_venc1_pipe4: power-controller@8008 {
		compatible = "apple,t6000-pmgr-pwrstate", "apple,pmgr-pwrstate";
		reg = <0x8008 4>;
		#power-domain-cells = <0>;
		#reset-cells = <0>;
		label = "venc1_pipe4";
		power-domains = <&ps_venc1_dma>;
	};

	ps_venc1_pipe5: power-controller@8010 {
		compatible = "apple,t6000-pmgr-pwrstate", "apple,pmgr-pwrstate";
		reg = <0x8010 4>;
		#power-domain-cells = <0>;
		#reset-cells = <0>;
		label = "venc1_pipe5";
		power-domains = <&ps_venc1_dma>;
	};

	ps_venc1_me0: power-controller@8018 {
		compatible = "apple,t6000-pmgr-pwrstate", "apple,pmgr-pwrstate";
		reg = <0x8018 4>;
		#power-domain-cells = <0>;
		#reset-cells = <0>;
		label = "venc1_me0";
		power-domains = <&ps_venc1_pipe4>, <&ps_venc1_pipe5>;
	};

	ps_venc1_me1: power-controller@8020 {
		compatible = "apple,t6000-pmgr-pwrstate", "apple,pmgr-pwrstate";
		reg = <0x8020 4>;
		#power-domain-cells = <0>;
		#reset-cells = <0>;
		label = "venc1_me1";
		power-domains = <&ps_venc1_me0>;
	};

	ps_prores: power-controller@c000 {
		compatible = "apple,t6000-pmgr-pwrstate", "apple,pmgr-pwrstate";
		reg = <0xc000 4>;
		#power-domain-cells = <0>;
		#reset-cells = <0>;
		label = "prores";
		power-domains = <&ps_afnc4_lw0>;
	};
};

&pmgr_mini {
	ps_debug: power-controller@58 {
		compatible = "apple,t6000-pmgr-pwrstate", "apple,pmgr-pwrstate";
		reg = <0x58 4>;
		#power-domain-cells = <0>;
		#reset-cells = <0>;
		label = "debug";
		apple,always-on; /* Core AON device */
	};

	ps_nub_spmi0: power-controller@60 {
		compatible = "apple,t6000-pmgr-pwrstate", "apple,pmgr-pwrstate";
		reg = <0x60 4>;
		#power-domain-cells = <0>;
		#reset-cells = <0>;
		label = "nub_spmi0";
		apple,always-on; /* Core AON device */
	};

	ps_nub_spmi1: power-controller@68 {
		compatible = "apple,t6000-pmgr-pwrstate", "apple,pmgr-pwrstate";
		reg = <0x68 4>;
		#power-domain-cells = <0>;
		#reset-cells = <0>;
		label = "nub_spmi1";
		apple,always-on; /* Core AON device */
	};

	ps_nub_aon: power-controller@70 {
		compatible = "apple,t6000-pmgr-pwrstate", "apple,pmgr-pwrstate";
		reg = <0x70 4>;
		#power-domain-cells = <0>;
		#reset-cells = <0>;
		label = "nub_aon";
		apple,always-on; /* Core AON device */
	};

	ps_msg: power-controller@78 {
		compatible = "apple,t6000-pmgr-pwrstate", "apple,pmgr-pwrstate";
		reg = <0x78 4>;
		#power-domain-cells = <0>;
		#reset-cells = <0>;
		label = "msg";
	};

	ps_nub_gpio: power-controller@80 {
		compatible = "apple,t6000-pmgr-pwrstate", "apple,pmgr-pwrstate";
		reg = <0x80 4>;
		#power-domain-cells = <0>;
		#reset-cells = <0>;
		label = "nub_gpio";
		apple,always-on; /* Core AON device */
	};

	ps_atc0_usb_aon: power-controller@88 {
		compatible = "apple,t6000-pmgr-pwrstate", "apple,pmgr-pwrstate";
		reg = <0x88 4>;
		#power-domain-cells = <0>;
		#reset-cells = <0>;
		label = "atc0_usb_aon";
	};

	ps_atc1_usb_aon: power-controller@90 {
		compatible = "apple,t6000-pmgr-pwrstate", "apple,pmgr-pwrstate";
		reg = <0x90 4>;
		#power-domain-cells = <0>;
		#reset-cells = <0>;
		label = "atc1_usb_aon";
	};

	ps_atc2_usb_aon: power-controller@98 {
		compatible = "apple,t6000-pmgr-pwrstate", "apple,pmgr-pwrstate";
		reg = <0x98 4>;
		#power-domain-cells = <0>;
		#reset-cells = <0>;
		label = "atc2_usb_aon";
	};

	ps_atc3_usb_aon: power-controller@a0 {
		compatible = "apple,t6000-pmgr-pwrstate", "apple,pmgr-pwrstate";
		reg = <0xa0 4>;
		#power-domain-cells = <0>;
		#reset-cells = <0>;
		label = "atc3_usb_aon";
	};

	ps_gp_usb_aon: power-controller@a8 {
		compatible = "apple,t6000-pmgr-pwrstate", "apple,pmgr-pwrstate";
		reg = <0xa8 4>;
		#power-domain-cells = <0>;
		#reset-cells = <0>;
		label = "gp_usb_aon";
	};

	ps_nub_fabric: power-controller@b0 {
		compatible = "apple,t6000-pmgr-pwrstate", "apple,pmgr-pwrstate";
		reg = <0xb0 4>;
		#power-domain-cells = <0>;
		#reset-cells = <0>;
		label = "nub_fabric";
		apple,always-on; /* Core AON device */
	};

	ps_nub_sram: power-controller@b8 {
		compatible = "apple,t6000-pmgr-pwrstate", "apple,pmgr-pwrstate";
		reg = <0xb8 4>;
		#power-domain-cells = <0>;
		#reset-cells = <0>;
		label = "nub_sram";
		apple,always-on; /* Core AON device */
	};

	ps_debug_usb: power-controller@c0 {
		compatible = "apple,t6000-pmgr-pwrstate", "apple,pmgr-pwrstate";
		reg = <0xc0 4>;
		#power-domain-cells = <0>;
		#reset-cells = <0>;
		label = "debug_usb";
		apple,always-on; /* Core AON device */
		power-domains = <&ps_debug>;
	};

	ps_debug_auth: power-controller@c8 {
		compatible = "apple,t6000-pmgr-pwrstate", "apple,pmgr-pwrstate";
		reg = <0xc8 4>;
		#power-domain-cells = <0>;
		#reset-cells = <0>;
		label = "debug_auth";
		apple,always-on; /* Core AON device */
		power-domains = <&ps_debug>;
	};

	ps_atc0_usb: power-controller@d0 {
		compatible = "apple,t6000-pmgr-pwrstate", "apple,pmgr-pwrstate";
		reg = <0xd0 4>;
		#power-domain-cells = <0>;
		#reset-cells = <0>;
		label = "atc0_usb";
		power-domains = <&ps_atc0_usb_aon>, <&ps_atc0_common>;
	};

	ps_atc1_usb: power-controller@d8 {
		compatible = "apple,t6000-pmgr-pwrstate", "apple,pmgr-pwrstate";
		reg = <0xd8 4>;
		#power-domain-cells = <0>;
		#reset-cells = <0>;
		label = "atc1_usb";
		power-domains = <&ps_atc1_usb_aon>, <&ps_atc1_common>;
	};

	ps_atc2_usb: power-controller@e0 {
		compatible = "apple,t6000-pmgr-pwrstate", "apple,pmgr-pwrstate";
		reg = <0xe0 4>;
		#power-domain-cells = <0>;
		#reset-cells = <0>;
		label = "atc2_usb";
		power-domains = <&ps_atc2_usb_aon>, <&ps_atc2_common>;
	};

	ps_atc3_usb: power-controller@e8 {
		compatible = "apple,t6000-pmgr-pwrstate", "apple,pmgr-pwrstate";
		reg = <0xe8 4>;
		#power-domain-cells = <0>;
		#reset-cells = <0>;
		label = "atc3_usb";
		power-domains = <&ps_atc3_usb_aon>, <&ps_atc3_common>;
	};
};

