// SPDX-License-Identifier: GPL-2.0+ OR MIT

	DIE_NODE(ane_dart0): iommu@285800000 {
		compatible = "apple,t6000-dart";
		reg = <0x2 0x85800000 0x0 0x4000>;
		#iommu-cells = <1>;
		interrupt-parent = <&aic>;
		interrupts = <AIC_IRQ DIE_NO 771 IRQ_TYPE_LEVEL_HIGH>;
		power-domains = <&DIE_NODE(ps_ane_sys)>;
	};

	DIE_NODE(ane_dart1): iommu@285810000 {
		compatible = "apple,t6000-dart";
		reg = <0x2 0x85810000 0x0 0x4000>;
		#iommu-cells = <1>;
		interrupt-parent = <&aic>;
		interrupts = <AIC_IRQ DIE_NO 771 IRQ_TYPE_LEVEL_HIGH>;
		power-domains = <&DIE_NODE(ps_ane_sys)>;
	};

	DIE_NODE(ane_dart2): iommu@285820000 {
		compatible = "apple,t6000-dart";
		reg = <0x2 0x85820000 0x0 0x4000>;
		#iommu-cells = <1>;
		interrupt-parent = <&aic>;
		interrupts = <AIC_IRQ DIE_NO 771 IRQ_TYPE_LEVEL_HIGH>;
		power-domains = <&DIE_NODE(ps_ane_sys)>;
	};

	DIE_NODE(ane): npu@285c04000 {
		compatible = "apple,t6000-ane";
		reg = <0x2 0x85c04000 0x0 0x24000>;
		interrupt-parent = <&aic>;
		interrupts = <AIC_IRQ DIE_NO 770 IRQ_TYPE_LEVEL_HIGH>;
		iommus = <&DIE_NODE(ane_dart0) 0>, <&DIE_NODE(ane_dart1) 0>,
			<&DIE_NODE(ane_dart2) 0>;
		power-domains = <&DIE_NODE(ps_ane_set1)>,
			<&DIE_NODE(ps_ane_set2)>, <&DIE_NODE(ps_ane_set3)>,
			<&DIE_NODE(ps_ane_set4)>, <&DIE_NODE(ps_ane_set5)>;
	};
