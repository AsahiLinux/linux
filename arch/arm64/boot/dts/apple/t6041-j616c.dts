// SPDX-License-Identifier: GPL-2.0+ OR MIT
/*
 * Apple MacBook Pro (16-inch, M4 Max, 2024)
 *
 * target-type: J616c
 *
 * Copyright The Asahi Linux Contributors
 */

/dts-v1/;

#include "t6041.dtsi"
#include "t604x-j614-j616.dtsi"

/ {
	model = "Apple MacBook Pro (16-inch, M4 Max, 2024)";
	compatible = "apple,j616c", "apple,t6041", "apple,arm-platform";
};
