// SPDX-License-Identifier: GPL-2.0+ OR MIT
/*
 * Apple T6020 "M2 Pro" SoC
 *
 * Other names: H14J, "Rhodes Chop"
 *
 * Copyright The Asahi Linux Contributors
 */

/* This chip is just a cut down version of t6021, so include it and disable the missing parts */

#define GPU_REPEAT(x) <x x>

#include "t6021.dtsi"

/ {
	compatible = "apple,t6020", "apple,arm-platform";
};

/delete-node/ &pmgr_south;
/delete-node/ &pmp_report_dispext2;
/delete-node/ &pmp_report_dispext3;
/delete-node/ &pmp_report_venc1;
/delete-node/ &pmp_report_msr1;
/delete-node/ &pmp_report_prores;

&pmp {
	apple,pio-ranges = <0x2 0x80000000 0x0 0x1000000>,
		<0x3 0x0 0x0 0x1000000>,
		<0x3 0x80000000 0x0 0x1000000>,
		<0x4 0x0 0x0 0x1000000>,
		<0x3 0x40000000 0x0 0x1000000>,
		<0x2 0x10e70000 0x0 0x90000>,
		<0x2 0x11e70000 0x0 0x90000>,
		<0x2 0x12e70000 0x0 0x90000>;
};

&gpu {
	compatible = "apple,agx-t6020", "apple,agx-g14x", "apple,agx-g14s";

	apple,avg-power-filter-tc-ms = <302>;
	apple,avg-power-ki-only = <2.6375>;
	apple,avg-power-kp = <0.18>;
	apple,fast-die0-integral-gain = <1350.0>;
	apple,ppm-filter-time-constant-ms = <32>;
	apple,ppm-ki = <28.0>;
};
