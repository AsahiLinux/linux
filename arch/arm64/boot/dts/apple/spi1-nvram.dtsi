// SPDX-License-Identifier: GPL-2.0+ OR MIT
/*
 * Common config for Apple's nvram using a SPI nor flash. This is common on all
 * M1 and M2 devices.  identically set up identically on all M1 and M2 devicesspi1, spinor and nvram config identical on all devices
 *
 * Copyright The Asahi Linux Contributors
 */

&spi1 {
	status = "okay";

	flash@0 {
		compatible = "jedec,spi-nor";
		reg = <0x0>;
		spi-max-frequency = <25000000>;
		#address-cells = <1>;
		#size-cells = <1>;

		partitions {
			compatible = "fixed-partitions";
			#address-cells = <1>;
			#size-cells = <1>;

			nvram: partition@700000 {
				label = "nvram";
				/* To be filled by the loader */
				reg = <0x0 0x0>;
				status = "disabled";
			};
		};
	};
};
