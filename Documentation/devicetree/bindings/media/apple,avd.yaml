## Documentation/devicetree/bindings/media/apple,avd.yaml
```yaml
# SPDX-License-Identifier: GPL-2.0-only OR BSD-2-Clause
%YAML 1.2
---
$id: http://devicetree.org/schemas/media/apple,avd.yaml#
$schema: http://devicetree.org/meta-schemas/core.yaml#

title: Apple AVD (Apple Video Decoder)

description:
  AVD is a video decode block present on all apple silicon devices.

maintainers:
  - Sofus <sofus.c@icloud.com>

properties:
  compatible:
    oneOf:
      - items:
          - enum:
              - apple,t6030-avd
              - apple,t6031-avd
          - const: apple,t8122-avd
      - enum:
          - apple,t8103-avd
          - apple,t6000-avd
          - apple,t8112-avd
          - apple,t6020-avd
          - apple,t8122-avd

  reg:
    items:
      - description: cm3 code
      - description: cm3 sram
      - description: mbox registers
      - description: decode ctrl registers

  reg-names:
    items:
      - const: code
      - const: sram
      - const: mbox
      - const: ctrl

  iommus:
    minItems: 1
    maxItems: 3

  power-domains:
    maxItems: 1

  resets:
    maxItems: 1

  interrupts:
    minItems: 2
    items:
      - description: mailbox 0
      - description: mailbox 1
      - description: mailbox 2
      - description: mailbox 3
      - description: flag 0
      - description: flag 1

required:
  - compatible
  - reg
  - interrupts
  - reg-names
  - iommus
  - power-domains
  - resets

additionalProperties: false

examples:
  - |
    #include <dt-bindings/interrupt-controller/apple-aic.h>
    #include <dt-bindings/interrupt-controller/irq.h>

    soc {
        #address-cells = <2>;
        #size-cells = <2>;

        avd: avd@288000000 {
            compatible = "apple,t8122-avd";
            interrupt-parent = <&aic>;
            interrupts = <AIC_IRQ 679 IRQ_TYPE_LEVEL_HIGH>,
                         <AIC_IRQ 680 IRQ_TYPE_LEVEL_HIGH>;
            power-domains = <&ps_avd_sys>;
            resets = <&ps_avd_sys>;
            reg = <0x2 0x89080000 0x0 0x12000>,
                  <0x2 0x89092000 0x0 0x12000>,
                  <0x2 0x890a4000 0x0 0x4000>,
                  <0x2 0x89100000 0x0 0x10000>;
            reg-names = "code", "sram", "mbox", "ctrl";
            iommus = <&avd_dart 0>;
        };
    };
```

## Documentation/devicetree/bindings/npu/apple,ane.yaml
```yaml
# SPDX-License-Identifier: (GPL-2.0-only OR BSD-2-Clause)
%YAML 1.2
---
$id: http://devicetree.org/schemas/npu/apple,ane.yaml#
$schema: http://devicetree.org/meta-schemas/core.yaml#

title: Apple Neural Engine

maintainers:
  - Christian Tramnitz <christian@tramnitz.com>

description: |
  Apple SoCs contain a Neural Engine accelerator. The accelerator is connected
  through three DART IOMMU instances.

properties:
  $nodename:
    pattern: '^npu@[0-9a-f]+$'

  compatible:
    enum:
      - apple,t8103-ane
      - apple,t6000-ane
      - apple,t8112-ane
      - apple,t6020-ane

  reg:
    maxItems: 1

  interrupts:
    maxItems: 1

  iommus:
    minItems: 3
    maxItems: 3

  power-domains:
    minItems: 1
    maxItems: 5

allOf:
  - if:
      properties:
        compatible:
          enum:
            - apple,t8103-ane
            - apple,t6000-ane
    then:
      properties:
        power-domains:
          minItems: 5
          maxItems: 5
    else:
      properties:
        power-domains:
          maxItems: 1

required:
  - compatible
  - reg
  - interrupts
  - iommus
  - power-domains

additionalProperties: false
```

## Documentation/devicetree/bindings/power/apple,pmp-v1-report-entry.yaml
```yaml
# SPDX-License-Identifier: (GPL-2.0-only OR BSD-2-Clause)
%YAML 1.2
---
$id: http://devicetree.org/schemas/power/apple,pmp-v1-report-entry.yaml#
$schema: http://devicetree.org/meta-schemas/core.yaml#

title: Apple PMPv1 Report Entry Power Domains

maintainers:
  - Didi Nuk <dev@ydnuk.com>

description:
  Apple PMPv1 report-entry nodes expose individual PMP-managed resources as
  generic power domains. The PMP driver requires a report-entry node for each
  SoC-specific PMP-managed resource.

properties:
  compatible:
    const: apple,t8103-pmp-v1-report-entry

  reg:
    maxItems: 1

  "#power-domain-cells":
    const: 0

  power-domains:
    maxItems: 1

  label:
    description:
      Specifies the name of the SoC report entry domain. This is used to
      name the report entry domains.

  apple,always-on:
    description:
      Forces this power domain to always be powered up.
    type: boolean

required:
  - compatible
  - reg
  - label
  - "#power-domain-cells"
  - power-domains

additionalProperties: false
```

## Documentation/devicetree/bindings/power/apple,pmp-v1.yaml
```yaml
# SPDX-License-Identifier: (GPL-2.0-only OR BSD-2-Clause)
%YAML 1.2
---
$id: http://devicetree.org/schemas/power/apple,pmp-v1.yaml#
$schema: http://devicetree.org/meta-schemas/core.yaml#

title: Apple PMPv1 Power Domains

maintainers:
  - Didi Nuk <dev@ydnuk.com>

description:
  Apple PMPv1 power domains are controlled by the Apple Power Management
  Processor (PMP).

properties:
  compatible:
    const: apple,t8103-pmp-v1

  reg:
    maxItems: 2

  reg-names:
    items:
      - const: pmp
      - const: asc

  mboxes:
    maxItems: 1

  mbox-names:
    items:
      - const: mbox

  iommus:
    maxItems: 1

  "#address-cells":
    const: 1

  "#size-cells":
    const: 0

  power-domains:
    maxItems: 1

  apple,init-ranges:
    description:
      List of PMP memory regions, represented as address and size pairs for
      initializing PMP.
    $ref: /schemas/types.yaml#/definitions/uint32-array
    minItems: 2

  apple,init-dva:
    description:
      List of device virtual address with count pairs for initializing PMP.
    $ref: /schemas/types.yaml#/definitions/uint32-array
    minItems: 2

required:
  - compatible
  - reg
  - reg-names
  - mboxes
  - mbox-names
  - "#address-cells"
  - "#size-cells"
  - iommus
  - apple,init-ranges
  - apple,init-dva

patternProperties:
  "^report@[0-9a-f]+$":
    $ref: apple,pmp-v1-report-entry.yaml#

additionalProperties: false
```

## Documentation/devicetree/bindings/reset/apple,t8103-cio-reset.yaml
```yaml
# SPDX-License-Identifier: (GPL-2.0-only OR BSD-2-Clause)
%YAML 1.2
---
$id: http://devicetree.org/schemas/reset/apple,t8103-cio-reset.yaml#
$schema: http://devicetree.org/meta-schemas/core.yaml#

title: Apple SoC CIO (USB4/Thunderbolt) block reset controller

maintainers:
  - Sven Peter <sven@kernel.org>

description: |
  The CIO (Converged I/O) blocks on Apple Silicon SoCs have a reset
  inside the power manager (PMGR) that has to be deasserted before
  their co-processor can be booted. On t8103 each port comes with a
  dedicated register page, represented as a standalone node. On t600x a
  single register shared by all ports of a die with one request bit per
  port is used instead. Since this register is located in the middle of
  the PMGR MMIO region it is represented as a sub-node of the PMGR
  syscon with reg used as an offset into it.

  In both cases the reset id is the CIO port index on the die.

properties:
  compatible:
    oneOf:
      - enum:
          - apple,t8103-cio-reset
          - apple,t6000-cio-reset
      - items:
          - const: apple,t8112-cio-reset
          - const: apple,t8103-cio-reset
      - items:
          - const: apple,t6020-cio-reset
          - const: apple,t6000-cio-reset

  reg:
    maxItems: 1

  '#reset-cells':
    const: 1

required:
  - compatible
  - reg
  - '#reset-cells'

additionalProperties: false

examples:
  - |
    soc {
        #address-cells = <2>;
        #size-cells = <2>;

        reset-controller@23b784000 {
            compatible = "apple,t8103-cio-reset";
            reg = <0x2 0x3b784000 0x0 0x8000>;
            #reset-cells = <1>;
        };
    };
```

## Documentation/devicetree/bindings/usb/apple,sn201202x.yaml
```yaml
# SPDX-License-Identifier: (GPL-2.0-only OR BSD-2-Clause)
%YAML 1.2
---
$id: http://devicetree.org/schemas/usb/apple,sn201202x.yaml#
$schema: http://devicetree.org/meta-schemas/core.yaml#

title: Texas Instruments sn201202x Type-C Power Delivery controller

maintainers:
  - Sasha Finkelstein <k@chaosmail.tech>

description: |
  Texas Instruments sn201202x Type-C Power Delivery controller

  A variant of tps6598x controller also known as Apple ACE3
  present on hardware with Apple SoCs starting from the M3.

properties:
  compatible:
    enum:
      - apple,sn201202x

  reg:
    maxItems: 1

  interrupts:
    items:
      - description: Primary irq used for tps6598x events
      - description: Logical register selection completed
      - description: Standby command completed
      - description: Wakeup command completed

  interrupt-names:
    items:
      - const: irq
      - const: select
      - const: sleep
      - const: wake

  connector:
    $ref: /schemas/connector/usb-connector.yaml#

required:
  - compatible
  - reg
  - interrupts
  - interrupt-names

additionalProperties: false

examples:
  - |
    #include <dt-bindings/interrupt-controller/irq.h>
    #include <dt-bindings/spmi/spmi.h>
    spmi {
        #address-cells = <2>;
        #size-cells = <0>;
        usb-pd@c {
            compatible = "apple,sn201202x";
            reg = <0xc SPMI_USID>;
            interrupts = <11 IRQ_TYPE_EDGE_RISING>,
                         <13 IRQ_TYPE_EDGE_RISING>,
                         <17 IRQ_TYPE_EDGE_RISING>,
                         <19 IRQ_TYPE_EDGE_RISING>;
            interrupt-names = "irq", "select", "sleep", "wake";

            connector {
                compatible = "usb-c-connector";
                label = "USB-C";

                port {
                    typec_ep: endpoint {
                        remote-endpoint = <&otg_ep>;
                    };
                };
            };
        };
    };
```

## drivers/media/platform/apple/Kconfig
```kconfig
# SPDX-License-Identifier: GPL-2.0-only

comment "Apple media platform drivers"

source "drivers/media/platform/apple/isp/Kconfig"
source "drivers/media/platform/apple/avd/Kconfig"
```

## drivers/media/platform/apple/avd/Kconfig
```kconfig
# SPDX-License-Identifier: GPL-2.0-only

config VIDEO_APPLE_AVD
	tristate "Apple Silicon Video Decoding driver"
	depends on VIDEO_DEV
	depends on MEDIA_CONTROLLER
	depends on ARCH_APPLE || COMPILE_TEST
	depends on OF_ADDRESS
	depends on V4L_PLATFORM_DRIVERS
	select V4L2_MEM2MEM_DEV
	select VIDEOBUF2_DMA_CONTIG
	select V4L2_H264
```

## drivers/usb/typec/tipd/Kconfig
```kconfig
config TYPEC_TPS6598X_CORE
	tristate
	select USB_ROLE_SWITCH
	select POWER_SUPPLY

config TYPEC_TPS6598X
	tristate "TI TPS6598x USB Power Delivery controller driver"
	depends on I2C
	select REGMAP_I2C
	select TYPEC_TPS6598X_CORE
	help
	  Say Y or M here if your system has TI TPS65982 or TPS65983 USB Power
	  Delivery controller.

	  If you choose to build this driver as a dynamically linked module, the
	  module will be called tps6598x.ko.

config TYPEC_SN201202X
	tristate "TI SN201202x USB Power Delivery controller support"
	depends on SPMI
	select TYPEC_TPS6598X_CORE
	help
	  Say Y here to enable support for SN201202x, a TPS6598x variant
	  that uses SPMI as a host bus, and is found on Apple devices starting
	  from the M3 series.

	  If you choose to build this driver as a dynamically linked module, the
	  module will be called sn201202x.ko.
```
