## drivers/iio/common/aop_sensors/Kconfig
```kconfig
# SPDX-License-Identifier: GPL-2.0-only OR MIT

config IIO_AOP_SENSOR_LAS
	tristate "AOP Lid angle sensor"
	depends on ARCH_APPLE || COMPILE_TEST
	depends on RUST
	depends on SYSFS
	select APPLE_AOP
	default m if ARCH_APPLE
	help
	  Module to handle the lid angle sensor attached to the AOP
	  coprocessor on Apple laptops.

config IIO_AOP_SENSOR_ALS
	tristate "AOP Ambient light sensor"
	depends on ARCH_APPLE || COMPILE_TEST
	depends on RUST
	depends on SYSFS
	select APPLE_AOP
	default m if ARCH_APPLE
	help
	  Module to handle the ambient light sensor attached to the AOP
	  coprocessor on Apple laptops.
```

## drivers/media/platform/apple/isp/Kconfig
```kconfig
# SPDX-License-Identifier: GPL-2.0-only

config VIDEO_APPLE_ISP
	tristate "Apple Silicon Image Signal Processor driver"
	select VIDEOBUF2_CORE
	select VIDEOBUF2_V4L2
	select VIDEOBUF2_DMA_SG
	depends on ARCH_APPLE || COMPILE_TEST
	depends on V4L_PLATFORM_DRIVERS
	depends on VIDEO_DEV
```

## drivers/phy/apple/Kconfig
```kconfig
# SPDX-License-Identifier: GPL-2.0 OR BSD-2-Clause
config PHY_APPLE_ATC
	tristate "Apple Type-C PHY"
	depends on (ARM64 && ARCH_APPLE) || (COMPILE_TEST && !GENERIC_ATOMIC64)
	depends on TYPEC
	select GENERIC_PHY
	select APPLE_TUNABLE
	help
	  Enable this to add support for the Apple Type-C PHY found in
	  Apple Silicon M-series SoCs. This PHY supports USB2,
	  USB3, USB4, Thunderbolt, and DisplayPort.

	  If M is selected the module will be called 'phy-apple-atc'.

config PHY_APPLE_DPTX
	tristate "Apple DPTX PHY"
	depends on ARCH_APPLE || COMPILE_TEST
	select GENERIC_PHY
	help
	  Enable this to add support for the Apple DPTX PHY found on Apple SoCs
	  such as the M2.
	  This driver provides support for DisplayPort and is used on the
	  Mac mini (M2 and M2 Pro, 2023).
```

## drivers/platform/apple/Kconfig
```kconfig
# SPDX-License-Identifier: GPL-2.0
#
# Apple Platform-Specific Drivers
#

menuconfig APPLE_PLATFORMS
	bool "Apple Mac Platform-Specific Device Drivers"
	default y
	help
	  Say Y here to get to see options for platform-specific device drivers
	  for Apple devices. This option alone does not add any kernel code.

	  If you say N, all options in this submenu will be skipped and disabled.

if APPLE_PLATFORMS

config APPLE_SMC
	tristate "Apple SMC Driver"
	depends on ARCH_APPLE || (COMPILE_TEST && 64BIT)
	default ARCH_APPLE
	select MFD_CORE
	help
	  Build support for the Apple System Management Controller present in
	  Apple Macs. This driver currently supports the SMC in Apple Silicon
	  Macs. For x86 Macs, see the applesmc driver (SENSORS_APPLESMC).

	  Say Y here if you have an Apple Silicon Mac.

	  To compile this driver as a module, choose M here: the module will
	  be called macsmc.

if APPLE_SMC

config APPLE_SMC_RTKIT
	tristate "RTKit (Apple Silicon) backend"
	depends on ARCH_APPLE || (COMPILE_TEST && 64BIT)
	depends on APPLE_RTKIT
	default ARCH_APPLE
	help
	  Build support for SMC communications via the RTKit backend. This is
	  required for Apple Silicon Macs.

	  Say Y here if you have an Apple Silicon Mac.

	  To compile this driver as a module, choose M here: the module will
	  be called macsmc-rtkit.

endif
endif
```

## drivers/soc/apple/Kconfig
```kconfig
# SPDX-License-Identifier: GPL-2.0-only

if ARCH_APPLE || COMPILE_TEST

menu "Apple SoC drivers"

config APPLE_PMGR_PWRSTATE
	bool "Apple SoC PMGR power state control"
	depends on PM
	select REGMAP
	select MFD_SYSCON
	select PM_GENERIC_DOMAINS
	select RESET_CONTROLLER
	default ARCH_APPLE
	help
	  The PMGR block in Apple SoCs provides high-level power state
	  controls for SoC devices. This driver manages them through the
	  generic power domain framework, and also provides reset support.

config APPLE_PMGR_MISC
	bool "Apple SoC PMGR miscellaneous support"
	depends on PM
	default ARCH_APPLE
	help
	  The PMGR block in Apple SoCs provides high-level power state
	  controls for SoC devices. This driver manages miscellaneous
	  power controls.

config APPLE_MBOX
	tristate "Apple SoC mailboxes"
	depends on PM
	depends on ARCH_APPLE || (64BIT && COMPILE_TEST)
	default ARCH_APPLE
	help
	  Apple SoCs have various co-processors required for certain
	  peripherals to work (NVMe, display controller, etc.). This
	  driver adds support for the mailbox controller used to
	  communicate with those.

	  Say Y here if you have a Apple SoC.

config APPLE_RTKIT
	tristate "Apple RTKit co-processor IPC protocol"
	depends on APPLE_MBOX
	depends on ARCH_APPLE || COMPILE_TEST
	default ARCH_APPLE
	help
	  Apple SoCs such as the M1 come with various co-processors running
	  their proprietary RTKit operating system. This option enables support
	  for the protocol library used to communicate with those. It is used
	  by various client drivers.

	  Say 'y' here if you have an Apple SoC.

config APPLE_RTKIT_HELPER
	tristate "Apple Generic RTKit helper co-processor"
	depends on APPLE_RTKIT
	depends on ARCH_APPLE || COMPILE_TEST
	default ARCH_APPLE
	help
	  Apple SoCs such as the M1 come with various co-processors running
	  their proprietary RTKit operating system. This option enables support
	  for a generic co-processor that does not implement any additional
	  in-band communications. It can be used for testing purposes, or for
	  coprocessors such as MTP that communicate over a different interface.

	  Say 'y' here if you have an Apple SoC.

config APPLE_SART
	tristate "Apple SART DMA address filter"
	depends on ARCH_APPLE || COMPILE_TEST
	default ARCH_APPLE
	help
	  Apple SART is a simple DMA address filter used on Apple SoCs such
	  as the M1. It is usually required for the NVMe coprocessor which does
	  not use a proper IOMMU.

	  Say 'y' here if you have an Apple SoC.

config APPLE_DOCKCHANNEL
	tristate "Apple DockChannel FIFO"
	depends on ARCH_APPLE || COMPILE_TEST
	default ARCH_APPLE
	help
	  DockChannel is a simple FIFO used on Apple SoCs for debug and inter-processor
	  communications.

	  Say 'y' here if you have an Apple SoC.

endmenu

endif
```

## sound/soc/apple/Kconfig
```kconfig
config SND_SOC_APPLE_MCA
	tristate "Apple Silicon MCA driver"
	depends on ARCH_APPLE || COMPILE_TEST
	select SND_DMAENGINE_PCM
	default ARCH_APPLE
	help
	  This option enables an ASoC platform driver for MCA peripherals found
	  on Apple Silicon SoCs.

config SND_SOC_APPLE_MACAUDIO
	tristate "Sound support for Apple Silicon Macs"
	depends on ARCH_APPLE || COMPILE_TEST
	select SND_SOC_APPLE_MCA
	select SND_SIMPLE_CARD_UTILS
	select APPLE_ADMAC if DMADEVICES
	select COMMON_CLK_APPLE_NCO if COMMON_CLK
	select SND_SOC_TAS2764 if I2C
	select SND_SOC_TAS2770 if I2C
	select SND_SOC_CS42L83 if I2C
	select SND_SOC_CS42L84 if I2C
	select REGULATOR_FIXED_VOLTAGE if REGULATOR
	default ARCH_APPLE
	help
	  This option enables an ASoC machine-level driver for Apple Silicon Macs
	  and it also enables the required SoC and codec drivers for overall
	  sound support on these machines.
```
