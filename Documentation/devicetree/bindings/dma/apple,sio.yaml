## Documentation/devicetree/bindings/dma/apple,sio.yaml
```yaml
# SPDX-License-Identifier: GPL-2.0-only OR BSD-2-Clause
%YAML 1.2
---
$id: http://devicetree.org/schemas/dma/apple,sio.yaml#
$schema: http://devicetree.org/meta-schemas/core.yaml#

title: Apple SIO Coprocessor

description:
  SIO is a coprocessor on Apple M1 and later chips (and maybe also on earlier
  chips). Its role is to offload SPI, UART and DisplayPort audio transfers,
  being a pretend DMA controller.

maintainers:
  - Martin Povišer <povik+lin@cutebit.org>

allOf:
  - $ref: dma-controller.yaml#

properties:
  compatible:
    items:
      - enum:
          - apple,t6000-sio
          - apple,t8103-sio
      - const: apple,sio

  reg:
    maxItems: 1

  '#dma-cells':
    const: 1
    description:
      DMA clients specify a single cell that corresponds to the RTKit endpoint
      number used for arranging the transfers in question

  dma-channels:
    maximum: 128

  mboxes:
    maxItems: 1

  iommus:
    maxItems: 1

  power-domains:
    maxItems: 1

  memory-region:
    minItems: 2
    maxItems: 8
    description:
      A number of references to reserved memory regions among which are the DATA/TEXT
      sections of coprocessor executable firmware and also auxiliary firmware data
      describing the available DMA-enabled peripherals

  apple,sio-firmware-params:
    $ref: /schemas/types.yaml#/definitions/uint32-array
    description: |
      Parameters in the form of opaque key/value pairs that are to be sent to the SIO
      coprocesssor once it boots. These parameters can point into the reserved memory
      regions (in device address space).

      Note that unlike Apple's firmware, we treat the parameters, and the data they
      refer to, as opaque. Apple embed short data blobs into their SIO devicetree node
      that describe the DMA-enabled peripherals (presumably with defined semantics).
      Their driver processes those blobs and sets up data structure in mapped device
      memory, then references this memory in the parameters sent to the SIO. At the
      level of description we are opting for in this binding, we assume the job of
      constructing those data structures has been done in advance, leaving behind an
      opaque list of key/value parameter pairs to be sent by a prospective driver.

      This approach is chosen for two reasons:

       - It means we don't need to try to understand the semantics of Apple's blobs
         as long as we know the transformation we need to do from Apple's devicetree
         data to SIO data (which can be shoved away into a loader). It also means the
         semantics of Apple's blobs (or of something to replace them) need not be part
         of the binding and be kept up with Apple's firmware changes in the future.

       - It leaves less work for the driver attaching on this binding. Instead the work
         is done upfront in the loader which can be better suited for keeping up with
         Apple's firmware changes.

required:
  - compatible
  - reg
  - '#dma-cells'
  - dma-channels
  - mboxes
  - iommus
  - power-domains

additionalProperties: false

examples:
  - |
    sio: dma-controller@36400000 {
      compatible = "apple,t8103-sio", "apple,sio";
      reg = <0x36400000 0x8000>;
      dma-channels = <128>;
      #dma-cells = <1>;
      mboxes = <&sio_mbox>;
      iommus = <&sio_dart 0>;
      power-domains = <&ps_sio_cpu>;
      memory-region = <&sio_text>, <&sio_data>,
                      <&sio_auxdata1>, <&sio_auxdata2>; /* Filled by loader */
      apple,sio-firmware-params = <0xb 0x10>, <0xc 0x1b80>, <0xf 0x14>,
                                  <0x10 0x1e000>, <0x30d 0x34>, <0x30e 0x4000>,
                                  <0x1a 0x38>, <0x1b 0x50>; /* Filled by loader */
    };
```

## Documentation/devicetree/bindings/input/touchscreen/apple,z2-touchscreen.yaml
```yaml
# SPDX-License-Identifier: (GPL-2.0 OR BSD-2-Clause)
%YAML 1.2
---
$id: http://devicetree.org/schemas/input/touchscreen/apple,z2-touchscreen.yaml#
$schema: http://devicetree.org/meta-schemas/core.yaml#

title: Apple touchscreens attached using the Z2 protocol.

maintainers:
  - asahi@lists.linux.dev
  - Sasha Finkelstein <fnkl.kernel@gmail.com>

description: A series of touschscreen controllers used in Apple products.

allOf:
  - $ref: touchscreen.yaml#
  - $ref: /schemas/spi/spi-peripheral-props.yaml#

properties:
  compatible:
    items:
      - enum:
          - apple,j293-touchbar
          - apple,j493-touchbar
      - const: apple,z2-touchbar
      - const: apple,z2-multitouch

  reg:
    maxItems: 1

  interrupts:
    maxItems: 1

  reset-gpios:
    maxItems: 1

  cs-gpios:
    maxItems: 1

  firmware-name:
    maxItems: 1

  label:
    maxItems: 1

  touchscreen-size-x: true
  touchscreen-size-y: true
  spi-max-frequency: true
  spi-cs-hold-delay-ns: true
  spi-cs-setup-delay-ns: true

required:
  - compatible
  - interrupts
  - reset-gpios
  - firmware-name
  - label
  - touchscreen-size-x
  - touchscreen-size-y

additionalProperties: false

examples:
  - |
    #include <dt-bindings/gpio/gpio.h>
    #include <dt-bindings/interrupt-controller/irq.h>

    spi {
        #address-cells = <1>;
        #size-cells = <0>;

        touchscreen@0 {
            compatible = "apple,j293-touchbar", "apple,z2-touchbar",
              "apple,z2-multitouch";
            reg = <0>;
            spi-max-frequency = <11500000>;
            reset-gpios = <&pinctrl_ap 139 0>;
            cs-gpios = <&pinctrl_ap 109 0>;
            interrupts-extended = <&pinctrl_ap 194 IRQ_TYPE_EDGE_FALLING>;
            firmware-name = "apple/dfrmtfw-j293.bin";
            touchscreen-size-x = <23045>;
            touchscreen-size-y = <640>;
            label = "MacBookPro17,1 Touch Bar";
        };
    };

...
```

## Documentation/devicetree/bindings/soc/apple/apple,sart.yaml
```yaml
# SPDX-License-Identifier: GPL-2.0 OR BSD-2-Clause
%YAML 1.2
---
$id: http://devicetree.org/schemas/soc/apple/apple,sart.yaml#
$schema: http://devicetree.org/meta-schemas/core.yaml#

title: Apple SART DMA address filter

maintainers:
  - Sven Peter <sven@svenpeter.dev>

description:
  Apple SART is a simple address filter for some DMA transactions.
  Regions of physical memory must be added to the SART's allow
  list before before any DMA can target these. Unlike a proper
  IOMMU no remapping can be done and special support in the
  consumer driver is required since not all DMA transactions of
  a single device are subject to SART filtering.

properties:
  compatible:
    const: apple,t8103-sart

  reg:
    maxItems: 1

  clocks:
    description:
      Reference to the clock gate phandle(s) if required before accessing
      the MMIO region of this SART.

required:
  - compatible
  - reg

additionalProperties: false

examples:
  - |
        sart@7bc50000 {
                compatible = "apple,t8103-sart";
                reg = <0x2 0x7bc50000 0x0 0x10000>;
        };
```

## Documentation/devicetree/bindings/sound/apple,macaudio.yaml
```yaml
# SPDX-License-Identifier: (GPL-2.0-only OR BSD-2-Clause)
%YAML 1.2
---
$id: http://devicetree.org/schemas/sound/apple,macaudio.yaml#
$schema: http://devicetree.org/meta-schemas/core.yaml#

title: Apple Silicon Macs integrated sound peripherals

description:
  This binding represents the overall machine-level integration of sound
  peripherals on 'Apple Silicon' machines by Apple.

maintainers:
  - Martin Povišer <povik+lin@cutebit.org>

properties:
  compatible:
    items:
      - enum:
          - apple,j274-macaudio
          - apple,j293-macaudio
          - apple,j314-macaudio
      - const: apple,macaudio

  "#address-cells":
    const: 1

  "#size-cells":
    const: 0

  model:
    description:
      Model name for presentation to users
    $ref: /schemas/types.yaml#/definitions/string

patternProperties:
  "^dai-link(@[0-9a-f]+)?$":
    description: |
      Node for each sound peripheral such as the speaker array, headphones jack,
      or microphone.
    type: object

    additionalProperties: false

    properties:
      reg:
        maxItems: 1

      link-name:
        description: |
          Name for the peripheral, expecting 'Speaker' or 'Speakers' if this is
          the speaker array.
        $ref: /schemas/types.yaml#/definitions/string

      cpu:
        type: object

        properties:
          sound-dai:
            description: |
              DAI list with CPU-side I2S ports involved in this peripheral.
            minItems: 1
            maxItems: 2

        required:
          - sound-dai

      codec:
        type: object

        properties:
          sound-dai:
            minItems: 1
            maxItems: 8
            description: |
              DAI list with the CODEC-side DAIs connected to the above CPU-side
              DAIs and involved in this sound peripheral.

              The list is in left/right order if applicable. If there are more
              than one CPU-side DAIs (there can be two), the CODECs must be
              listed first those connected to the first CPU, then those
              connected to the second.

              In addition, on some machines with many speaker codecs, the CODECs
              are listed in this fixed order:

              J293: Left Front, Left Rear, Right Front, Right Rear
              J314: Left Woofer 1, Left Tweeter, Left Woofer 2,
                    Right Woofer 1, Right Tweeter, Right Woofer 2

        required:
          - sound-dai

    required:
      - reg
      - cpu
      - codec

required:
  - compatible
  - model

additionalProperties: false

examples:
  - |
    mca: mca@9b600000 {
      compatible = "apple,t6000-mca", "apple,mca";
      reg = <0x9b600000 0x10000>,
            <0x9b500000 0x20000>;

      clocks = <&nco 0>, <&nco 1>, <&nco 2>, <&nco 3>;
      power-domains = <&ps_audio_p>, <&ps_mca0>, <&ps_mca1>,
                      <&ps_mca2>, <&ps_mca3>;
      dmas = <&admac 0>, <&admac 1>, <&admac 2>, <&admac 3>,
             <&admac 4>, <&admac 5>, <&admac 6>, <&admac 7>,
             <&admac 8>, <&admac 9>, <&admac 10>, <&admac 11>,
             <&admac 12>, <&admac 13>, <&admac 14>, <&admac 15>;
      dma-names = "tx0a", "rx0a", "tx0b", "rx0b",
                  "tx1a", "rx1a", "tx1b", "rx1b",
                  "tx2a", "rx2a", "tx2b", "rx2b",
                  "tx3a", "rx3a", "tx3b", "rx3b";

      #sound-dai-cells = <1>;
    };

    sound {
      compatible = "apple,j314-macaudio", "apple,macaudio";
      model = "MacBook Pro J314 integrated audio";

      #address-cells = <1>;
      #size-cells = <0>;

      dai-link@0 {
        reg = <0>;
        link-name = "Speakers";

        cpu {
          sound-dai = <&mca 0>, <&mca 1>;
        };
        codec {
          sound-dai = <&speaker_left_woof1>,
                      <&speaker_left_tweet>,
                      <&speaker_left_woof2>,
                      <&speaker_right_woof1>,
                      <&speaker_right_tweet>,
                      <&speaker_right_woof2>;
        };
      };

      dai-link@1 {
        reg = <1>;
        link-name = "Headphones Jack";

        cpu {
          sound-dai = <&mca 2>;
        };
        codec {
          sound-dai = <&jack_codec>;
        };
      };
    };
```

## Documentation/devicetree/bindings/usb/apple,dwc3.yaml
```yaml
# SPDX-License-Identifier: GPL-2.0
%YAML 1.2
---
$id: http://devicetree.org/schemas/usb/apple,dwc3.yaml#
$schema: http://devicetree.org/meta-schemas/core.yaml#

title: Apple Silicon DWC3 USB controller

maintainers:
  - Sven Peter <sven@svenpeter.dev>

description:
  On Apple Silicon SoCs such as the M1 each Type-C port has a corresponding
  USB controller based on the Synopsys DesignWare USB3 controller.

  The common content of this binding is defined in snps,dwc3.yaml.

allOf:
  - $ref: snps,dwc3.yaml#

select:
  properties:
    compatible:
      contains:
        const: apple,dwc3
  required:
    - compatible

properties:
  compatible:
    items:
      - enum:
          - apple,t8103-dwc3
          - apple,t6000-dwc3
      - const: apple,dwc3
      - const: snps,dwc3

  reg:
    maxItems: 1

  interrupts:
    maxItems: 1

unevaluatedProperties: false

required:
  - compatible
  - reg
  - interrupts

examples:
  - |
    #include <dt-bindings/interrupt-controller/apple-aic.h>
    #include <dt-bindings/interrupt-controller/irq.h>

    usb@82280000 {
      compatible = "apple,t8103-dwc3", "apple,dwc3", "snps,dwc3";
      reg = <0x82280000 0x10000>;
      interrupts = <AIC_IRQ 777 IRQ_TYPE_LEVEL_HIGH>;

      dr_mode = "otg";
      usb-role-switch;
      role-switch-default-mode = "host";
    };
```

## drivers/accel/ane/Kconfig
```kconfig
# SPDX-License-Identifier: GPL-2.0-only

config DRM_ACCEL_ANE
	tristate "Apple NPU (Neural Processing Unit"
	depends on DRM_ACCEL
```

## drivers/gpu/drm/apple/Kconfig
```kconfig
# SPDX-License-Identifier: GPL-2.0-only OR MIT
config DRM_APPLE
	tristate "DRM Support for Apple display controllers"
	depends on DRM && OF && ARM64
	depends on ARCH_APPLE || COMPILE_TEST
	depends on APPLE_RTKIT
	select DRM_KMS_HELPER
	select DRM_KMS_DMA_HELPER
	select DRM_GEM_DMA_HELPER
	select VIDEOMODE_HELPERS
	select MULTIPLEXER
	help
	  Say Y if you have an Apple Silicon chipset.

config DRM_APPLE_AUDIO
	bool "DisplayPort/HDMI Audio support"
	default y
	depends on DRM_APPLE
	depends on SND
	select SND_PCM
	select SND_DMAENGINE_PCM

config DRM_APPLE_DEBUG
	bool "Enable additional driver debugging"
	depends on DRM_APPLE
	depends on EXPERT # only for developers
```

## drivers/gpu/drm/asahi/Kconfig
```kconfig
# SPDX-License-Identifier: GPL-2.0

config RUST_DRM_SCHED
	bool
	select DRM_SCHED

config RUST_DRM_GEM_SHMEM_HELPER
	bool
	select DRM_GEM_SHMEM_HELPER

config RUST_APPLE_RTKIT
	bool
	select APPLE_RTKIT
	select APPLE_MBOX

config DRM_ASAHI
	tristate "Asahi (DRM support for Apple AGX GPUs)"
	depends on RUST
	depends on DRM
	depends on (ARM64 && ARCH_APPLE) || (COMPILE_TEST && !GENERIC_ATOMIC64)
	depends on MMU
	select RUST_DRM_SCHED
	select IOMMU_SUPPORT
	select IOMMU_IO_PGTABLE_LPAE
	select RUST_DRM_GEM_SHMEM_HELPER
	select RUST_APPLE_RTKIT
	help
	  DRM driver for Apple AGX GPUs (G13x, found in the M1 SoC family)

config DRM_ASAHI_DEBUG_ALLOCATOR
	bool "Use debug allocator"
	depends on DRM_ASAHI
	help
	  Use an alternate, simpler allocator which significantly reduces
	  performance, but can help find firmware- or GPU-side memory safety
	  issues. However, it can also trigger firmware bugs more easily,
	  so expect GPU crashes.

	  Say N unless you are debugging firmware structures or porting to a
	  new firmware version.
```

## drivers/hid/dockchannel-hid/Kconfig
```kconfig
# SPDX-License-Identifier: GPL-2.0-only OR MIT
menu "DockChannel HID support"
	depends on APPLE_DOCKCHANNEL

config HID_DOCKCHANNEL
	tristate "HID over DockChannel transport layer for Apple Silicon SoCs"
	default ARCH_APPLE
	depends on APPLE_DOCKCHANNEL && INPUT && OF && HID
	help
	  Say Y here if you use an M2 or later Apple Silicon based laptop.
	  The keyboard and touchpad are HID based devices connected via the
	  proprietary DockChannel interface.

endmenu
```

## drivers/hid/spi-hid/Kconfig
```kconfig
# SPDX-License-Identifier: GPL-2.0-only
menu "SPI HID support"
	depends on SPI

config SPI_HID_APPLE_OF
	tristate "HID over SPI transport layer for Apple Silicon SoCs"
	depends on INPUT && OF
	select SPI_HID_APPLE_CORE
	help
	  Say Y here if you use Apple Silicon based laptop. The keyboard and
	  touchpad are HID based devices connected via SPI.

	  If unsure, say N.

	  This support is also available as a module.  If so, the module
	  will be called spi-hid-apple-of. It will also build/depend on the
	  module spi-hid-apple.

endmenu

config SPI_HID_APPLE_CORE
	tristate
	select HID
	select CRC16
```
